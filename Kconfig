## ports/espressif/esp-idf-config/sdkconfig.defaults
```kconfig
#
# Espressif IoT Development Framework Configuration
#
#
# Partition Table
#
CONFIG_PARTITION_TABLE_CUSTOM=y
# end of Partition Table

#
# Component config
#
#
# Driver Configurations
#
#
# GPTimer Configuration
#
CONFIG_GPTIMER_CTRL_FUNC_IN_IRAM=y
CONFIG_GPTIMER_ISR_IRAM_SAFE=y
# end of GPTimer Configuration

# end of Driver Configurations

#
# PHY
#
# CONFIG_ESP_PHY_CALIBRATION_AND_DATA_STORAGE is not set
# end of PHY

#
# ESP System Settings
#
CONFIG_ESP_MAIN_TASK_STACK_SIZE=16384
# CONFIG_ESP_TASK_WDT_INIT is not set
# CONFIG_ESP_DEBUG_OCDAWARE is not set
# end of ESP System Settings

#
# Wi-Fi
#
# CONFIG_ESP_WIFI_NVS_ENABLED is not set
# end of Wi-Fi

#
# LWIP
#
CONFIG_LWIP_MAX_SOCKETS=8
CONFIG_LWIP_SO_RCVBUF=y
#
# TCP
#
CONFIG_LWIP_MAX_ACTIVE_TCP=4
CONFIG_LWIP_MAX_LISTENING_TCP=4
CONFIG_LWIP_TCP_SYNMAXRTX=6
CONFIG_LWIP_TCP_SND_BUF_DEFAULT=2880
CONFIG_LWIP_TCP_WND_DEFAULT=2880
CONFIG_LWIP_TCP_RTO_TIME=3000
# end of TCP

# end of LWIP

#
# mbedTLS
#
CONFIG_MBEDTLS_SSL_OUT_CONTENT_LEN=2048
#
# mbedTLS v3.x related
#
# CONFIG_MBEDTLS_SSL_KEEP_PEER_CERTIFICATE is not set
# end of mbedTLS v3.x related

#
# Certificate Bundle
#
CONFIG_MBEDTLS_CERTIFICATE_BUNDLE_DEFAULT_NONE=y
CONFIG_MBEDTLS_CUSTOM_CERTIFICATE_BUNDLE=y
CONFIG_MBEDTLS_CUSTOM_CERTIFICATE_BUNDLE_PATH="../../lib/certificates/data/roots.pem"
# end of Certificate Bundle

#
# TLS Key Exchange Methods
#
# CONFIG_MBEDTLS_KEY_EXCHANGE_RSA is not set
# end of TLS Key Exchange Methods

CONFIG_MBEDTLS_SSL_PROTO_DTLS=y
#
# Certificates
#
# CONFIG_MBEDTLS_PEM_WRITE_C is not set
# end of Certificates

# CONFIG_MBEDTLS_ECP_DP_SECP192R1_ENABLED is not set
# CONFIG_MBEDTLS_ECP_DP_SECP224R1_ENABLED is not set
# CONFIG_MBEDTLS_ECP_DP_SECP521R1_ENABLED is not set
# CONFIG_MBEDTLS_ECP_DP_SECP192K1_ENABLED is not set
# CONFIG_MBEDTLS_ECP_DP_SECP224K1_ENABLED is not set
# CONFIG_MBEDTLS_ECP_DP_BP256R1_ENABLED is not set
# CONFIG_MBEDTLS_ECP_DP_BP384R1_ENABLED is not set
# CONFIG_MBEDTLS_ECP_DP_BP512R1_ENABLED is not set
CONFIG_MBEDTLS_ECP_NIST_OPTIM=y
# CONFIG_MBEDTLS_ECP_FIXED_POINT_OPTIM is not set
# end of mbedTLS

#
# SPI Flash driver
#
# CONFIG_SPI_FLASH_YIELD_DURING_ERASE is not set
CONFIG_SPI_FLASH_WRITE_CHUNK_SIZE=4096
# end of SPI Flash driver

#
# Camera configuration
#
# CONFIG_OV7670_SUPPORT is not set
# CONFIG_NT99141_SUPPORT is not set
# CONFIG_OV2640_SUPPORT is not set
# CONFIG_GC2145_SUPPORT is not set
# CONFIG_GC032A_SUPPORT is not set
# CONFIG_GC0308_SUPPORT is not set
# CONFIG_BF3005_SUPPORT is not set
# CONFIG_BF20A6_SUPPORT is not set
# CONFIG_SC030IOT_SUPPORT is not set
# end of Camera configuration

# end of Component config

CONFIG_IDF_EXPERIMENTAL_FEATURES=y
# end of Espressif IoT Development Framework Configuration
```

## ports/stm32/Kconfig
```kconfig
if PORT_STM32

choice
    bool "Board"
    default STM32_BOARD_PYBV4

config STM32_BOARD_ADAFRUIT_F405_EXPRESS
    bool "Adafruit Feather STM32F405"
    select STM32_CMSIS_MCU_STM32F405XX

config STM32_BOARD_B_L072Z_LRWAN1
    bool "B-L072Z-LRWAN1"
    select STM32_CMSIS_MCU_STM32L072XX

config STM32_BOARD_B_L475E_IOT01A
    bool "B-L475E-IOT01A"
    select STM32_CMSIS_MCU_STM32L475XX

config STM32_BOARD_CERB40
    bool "Cerb40"
    select STM32_CMSIS_MCU_STM32F405XX

config STM32_BOARD_ESPRUINO_PICO
    bool "Espruino Pico"
    select STM32_CMSIS_MCU_STM32F401XE

config STM32_BOARD_HYDRABUS
    bool "HydraBus1.0"
    select STM32_CMSIS_MCU_STM32F405XX

config STM32_BOARD_LIMIFROG
    bool "LIMIFROG"
    select STM32_CMSIS_MCU_STM32F476XX

config STM32_BOARD_MIKROE_CLICKER2_STM32
    bool "MIKROE_CLICKER2_STM32"
    select STM32_CMSIS_MCU_STM32F407XX

config STM32_BOARD_NADHAT_PYBF405
    bool "NADHAT_PYBF405"
    select STM32_CMSIS_MCU_STM32F405XX

config STM32_BOARD_NETDUINO_PLUS_2
    bool "NetduinoPlus2"
    select STM32_CMSIS_MCU_STM32F405XX

config STM32_BOARD_NUCLEO_F091RC
    bool "NUCLEO-F091RC"
    select STM32_CMSIS_MCU_STM32F091XC

config STM32_BOARD_NUCLEO_F401RE
    bool "NUCLEO-F401RE"
    select STM32_CMSIS_MCU_STM32F401XE

config STM32_BOARD_NUCLEO_F411RE
    bool "NUCLEO-F411RE"
    select STM32_CMSIS_MCU_STM32F411XE

config STM32_BOARD_NUCLEO_F413ZH
    bool "NUCLEO-F413ZH"
    select STM32_CMSIS_MCU_STM32F413XX

config STM32_BOARD_NUCLEO_F429ZI
    bool "NUCLEO-F429ZI"
    select STM32_CMSIS_MCU_STM32F429XX

config STM32_BOARD_NUCLEO_F446RE
    bool "NUCLEO-F446RE"
    select STM32_CMSIS_MCU_STM32F446XX

config STM32_BOARD_NUCLEO_F722ZE
    bool "NUCLEO-F722ZE"
    select STM32_CMSIS_MCU_STM32F722XX

config STM32_BOARD_NUCLEO_F746ZG
    bool "NUCLEO-F746ZG"
    select STM32_CMSIS_MCU_STM32F746XX

config STM32_BOARD_NUCLEO_F767ZI
    bool "NUCLEO-F767ZI"
    select STM32_CMSIS_MCU_STM32F767XX

config STM32_BOARD_NUCLEO_H743ZI
    bool "NUCLEO_H743ZI"
    select STM32_CMSIS_MCU_STM32H743XX

config STM32_BOARD_NUCLEO_L073RZ
    bool "NUCLEO-L073RZ"
    select STM32_CMSIS_MCU_STM32L073XX

config STM32_BOARD_NUCLEO_L432KC
    bool "NUCLEO-L432KC"
    select STM32_CMSIS_MCU_STM32L432XX

config STM32_BOARD_NUCLEO_L452RE
    bool "NUCLEO-L452RE"
    select STM32_CMSIS_MCU_STM32L452XX

config STM32_BOARD_NUCLEO_L476RG
    bool "NUCLEO-L476RG"
    select STM32_CMSIS_MCU_STM32L476XX

config STM32_BOARD_NUCLEO_WB55
    bool "NUCLEO-WB55"
    select STM32_CMSIS_MCU_STM32WB55XX

config STM32_BOARD_OLIMEX_E407
    bool "OLIMEX STM32-E407"
    select STM32_CMSIS_MCU_STM32F407XX

config STM32_BOARD_PYBD_SF2
    bool "PYBD-SF2W"
    select STM32_CMSIS_MCU_STM32F722XX

config STM32_BOARD_PYBD_SF3
    bool "PYBD-SF3W"
    select STM32_CMSIS_MCU_STM32F733XX

config STM32_BOARD_PYBD_SF6
    bool "PYBD-SF6W"
    select STM32_CMSIS_MCU_STM32F767XX

config STM32_BOARD_PYBLITEV10
    bool "PYBLITEv1.0"
    select STM32_CMSIS_MCU_STM32F411XE

config STM32_BOARD_PYBV10
    bool "PYBv1.0"
    select STM32_CMSIS_MCU_STM32F405XX

config STM32_BOARD_PYBV11
    bool "PYBv1.1"
    select STM32_CMSIS_MCU_STM32F405XX

config STM32_BOARD_PYBV3
    bool "PYBv3"
    select STM32_CMSIS_MCU_STM32F405XX

config STM32_BOARD_PYBV4
    bool "PYBv4"
    select STM32_CMSIS_MCU_STM32F405XX

config STM32_BOARD_STM32F411DISC
    bool "F411DISC"
    select STM32_CMSIS_MCU_STM32F411XE

config STM32_BOARD_STM32F429DISC
    bool "F429I-DISCO"
    select STM32_CMSIS_MCU_STM32F429XX

config STM32_BOARD_STM32F439
    bool "CustomPCB"
    select STM32_CMSIS_MCU_STM32F439XX

config STM32_BOARD_STM32F4DISC
    bool "F4DISC"
    select STM32_CMSIS_MCU_STM32F407XX

config STM32_BOARD_STM32F769DISC
    bool "F769DISC"
    select STM32_CMSIS_MCU_STM32F769XX

config STM32_BOARD_STM32F7DISC
    bool "F7DISC"
    select STM32_CMSIS_MCU_STM32F746XX

config STM32_BOARD_STM32L476DISC
    bool "L476-DISCO"
    select STM32_CMSIS_MCU_STM32L476XX

config STM32_BOARD_STM32L496GDISC
    bool "L496G-DISCO"
    select STM32_CMSIS_MCU_STM32L496XX

config STM32_BOARD_USBDONGLE_WB55
    bool "USBDongle-WB55"
    select STM32_CMSIS_MCU_STM32WB55XX

endchoice # Board

# Map selected board from above to boards/ directory name
config STM32_BOARD
    string
    default "ADAFRUIT_F405_EXPRESS" if STM32_BOARD_ADAFRUIT_F405_EXPRESS
    default "B_L072Z_LRWAN1" if STM32_BOARD_B_L072Z_LRWAN1
    default "B_L475E_IOT01A" if STM32_BOARD_B_L475E_IOT01A
    default "CERB40" if STM32_BOARD_CERB40
    default "ESPRUINO_PICO" if STM32_BOARD_ESPRUINO_PICO
    default "HYDRABUS" if STM32_BOARD_HYDRABUS
    default "LIMIFROG" if STM32_BOARD_LIMIFROG
    default "MIKROE_CLICKER2_STM32" if STM32_BOARD_MIKROE_CLICKER2_STM32
    default "NADHAT_PYBF405" if STM32_BOARD_NADHAT_PYBF405
    default "NETDUINO_PLUS_2" if STM32_BOARD_NETDUINO_PLUS_2
    default "NUCLEO_F091RC" if STM32_BOARD_NUCLEO_F091RC
    default "NUCLEO_F401RE" if STM32_BOARD_NUCLEO_F401RE
    default "NUCLEO_F411RE" if STM32_BOARD_NUCLEO_F411RE
    default "NUCLEO_F413ZH" if STM32_BOARD_NUCLEO_F413ZH
    default "NUCLEO_F429ZI" if STM32_BOARD_NUCLEO_F429ZI
    default "NUCLEO_F446RE" if STM32_BOARD_NUCLEO_F446RE
    default "NUCLEO_F722ZE" if STM32_BOARD_NUCLEO_F722ZE
    default "NUCLEO_F746ZG" if STM32_BOARD_NUCLEO_F746ZG
    default "NUCLEO_F767ZI" if STM32_BOARD_NUCLEO_F767ZI
    default "NUCLEO_H743ZI" if STM32_BOARD_NUCLEO_H743ZI
    default "NUCLEO_L073RZ" if STM32_BOARD_NUCLEO_L073RZ
    default "NUCLEO_L432KC" if STM32_BOARD_NUCLEO_L432KC
    default "NUCLEO_L452RE" if STM32_BOARD_NUCLEO_L452RE
    default "NUCLEO_L476RG" if STM32_BOARD_NUCLEO_L476RG
    default "NUCLEO_WB55" if STM32_BOARD_NUCLEO_WB55
    default "OLIMEX_E407" if STM32_BOARD_OLIMEX_E407
    default "PYBD_SF2" if STM32_BOARD_PYBD_SF2
    default "PYBD_SF3" if STM32_BOARD_PYBD_SF3
    default "PYBD_SF6" if STM32_BOARD_PYBD_SF6
    default "PYBLITEV10" if STM32_BOARD_PYBLITEV10
    default "PYBV10" if STM32_BOARD_PYBV10
    default "PYBV11" if STM32_BOARD_PYBV11
    default "PYBV3" if STM32_BOARD_PYBV3
    default "PYBV4" if STM32_BOARD_PYBV4
    default "STM32F411DISC" if STM32_BOARD_STM32F411DISC
    default "STM32F429DISC" if STM32_BOARD_STM32F429DISC
    default "STM32F439" if STM32_BOARD_STM32F439
    default "STM32F4DISC" if STM32_BOARD_STM32F4DISC
    default "STM32F769DISC" if STM32_BOARD_STM32F769DISC
    default "STM32F7DISC" if STM32_BOARD_STM32F7DISC
    default "STM32L476DISC" if STM32_BOARD_STM32L476DISC
    default "STM32L496GDISC" if STM32_BOARD_STM32L496GDISC
    default "USBDONGLE_WB55" if STM32_BOARD_USBDONGLE_WB55


# Floating point unit

config STM32_FPU_VFP4_SP_D16
    bool
    select STM32_FPU_SUPPORTS_SINGLE

config STM32_FPU_VFP5_D16
    bool
    select STM32_FPU_SUPPORTS_SINGLE
    select STM32_FPU_SUPPORTS_DOUBLE

config STM32_FPU_SUPPORTS_SINGLE
    bool

config STM32_FPU_SUPPORTS_DOUBLE
    bool


# MCU Series

config STM32_MCU_SERIES_F0
    bool

config STM32_MCU_SERIES_L0
    bool

config STM32_MCU_SERIES_F4
    bool

config STM32_MCU_SERIES_L4
    bool

config STM32_MCU_SERIES_F7
    bool

config STM32_MCU_SERIES_H7
    bool

config STM32_MCU_SERIES_WB
    bool

# Map MCU series to string
config STM32_MCU_SERIES
    string
    default "F0" if STM32_MCU_SERIES_F0
    default "L0" if STM32_MCU_SERIES_L0
    default "F4" if STM32_MCU_SERIES_F4
    default "L4" if STM32_MCU_SERIES_L4
    default "F7" if STM32_MCU_SERIES_F7
    default "H7" if STM32_MCU_SERIES_H7
    default "WB" if STM32_MCU_SERIES_WB


# CMSIS MCU

config STM32_CMSIS_MCU_STM32F091XC
    bool
    select STM32_MCU_SERIES_F0

config STM32_CMSIS_MCU_STM32L072XX
    bool
    select STM32_MCU_SERIES_L0

config STM32_CMSIS_MCU_STM32L073XX
    bool
    select STM32_MCU_SERIES_L0

config STM32_CMSIS_MCU_STM32F401XE
    bool
    select STM32_MCU_SERIES_F4
    select STM32_FPU_VFP4_SP_D16

config STM32_CMSIS_MCU_STM32F405XX
    bool
    select STM32_MCU_SERIES_F4
    select STM32_FPU_VFP4_SP_D16

config STM32_CMSIS_MCU_STM32F407XX
    bool
    select STM32_MCU_SERIES_F4
    select STM32_FPU_VFP4_SP_D16

config STM32_CMSIS_MCU_STM32F411XE
    bool
    select STM32_MCU_SERIES_F4
    select STM32_FPU_VFP4_SP_D16

config STM32_CMSIS_MCU_STM32F413XX
    bool
    select STM32_MCU_SERIES_F4
    select STM32_FPU_VFP4_SP_D16

config STM32_CMSIS_MCU_STM32F429XX
    bool
    select STM32_MCU_SERIES_F4
    select STM32_FPU_VFP4_SP_D16

config STM32_CMSIS_MCU_STM32F439XX
    bool
    select STM32_MCU_SERIES_F4
    select STM32_FPU_VFP4_SP_D16

config STM32_CMSIS_MCU_STM32F446XX
    bool
    select STM32_MCU_SERIES_F4
    select STM32_FPU_VFP4_SP_D16

config STM32_CMSIS_MCU_STM32F476XX
    bool
    select STM32_MCU_SERIES_F4
    select STM32_FPU_VFP4_SP_D16

config STM32_CMSIS_MCU_STM32L432XX
    bool
    select STM32_MCU_SERIES_L4
    select STM32_FPU_VFP4_SP_D16

config STM32_CMSIS_MCU_STM32L452XX
    bool
    select STM32_MCU_SERIES_L4
    select STM32_FPU_VFP4_SP_D16

config STM32_CMSIS_MCU_STM32L475XX
    bool
    select STM32_MCU_SERIES_L4
    select STM32_FPU_VFP4_SP_D16

config STM32_CMSIS_MCU_STM32L476XX
    bool
    select STM32_MCU_SERIES_L4
    select STM32_FPU_VFP4_SP_D16

config STM32_CMSIS_MCU_STM32L496XX
    bool
    select STM32_MCU_SERIES_L4
    select STM32_FPU_VFP4_SP_D16

config STM32_CMSIS_MCU_STM32F722XX
    bool
    select STM32_MCU_SERIES_F7
    select STM32_FPU_VFP4_SP_D16

config STM32_CMSIS_MCU_STM32F733XX
    bool
    select STM32_MCU_SERIES_F7
    select STM32_FPU_VFP4_SP_D16

config STM32_CMSIS_MCU_STM32F746XX
    bool
    select STM32_MCU_SERIES_F7
    select STM32_FPU_VFP4_SP_D16

config STM32_CMSIS_MCU_STM32F765XX
    bool
    select STM32_MCU_SERIES_F7
    select STM32_FPU_VFP5_D16

config STM32_CMSIS_MCU_STM32F767XX
    bool
    select STM32_MCU_SERIES_F7
    select STM32_FPU_VFP5_D16

config STM32_CMSIS_MCU_STM32F769XX
    bool
    select STM32_MCU_SERIES_F7
    select STM32_FPU_VFP5_D16

config STM32_CMSIS_MCU_STM32H743XX
    bool
    select STM32_MCU_SERIES_H7
    select STM32_FPU_VFP5_D16

config STM32_CMSIS_MCU_STM32WB55XX
    bool
    select STM32_MCU_SERIES_WB
    select STM32_FPU_VFP4_SP_D16

# Map CMSIS series to string
config STM32_CMSIS_MCU
    string
    default "STM32F091xC" if STM32_CMSIS_MCU_STM32F091XC
    default "STM32L072xx" if STM32_CMSIS_MCU_STM32L072XX
    default "STM32L073xx" if STM32_CMSIS_MCU_STM32L073XX
    default "STM32F401xE" if STM32_CMSIS_MCU_STM32F401XE
    default "STM32F405xx" if STM32_CMSIS_MCU_STM32F405XX
    default "STM32F407xx" if STM32_CMSIS_MCU_STM32F407XX
    default "STM32F411xE" if STM32_CMSIS_MCU_STM32F411XE
    default "STM32F413xx" if STM32_CMSIS_MCU_STM32F413XX
    default "STM32F429xx" if STM32_CMSIS_MCU_STM32F429XX
    default "STM32F439xx" if STM32_CMSIS_MCU_STM32F439XX
    default "STM32F446xx" if STM32_CMSIS_MCU_STM32F446XX
    default "STM32F476xx" if STM32_CMSIS_MCU_STM32F476XX
    default "STM32L432xx" if STM32_CMSIS_MCU_STM32L432XX
    default "STM32L452xx" if STM32_CMSIS_MCU_STM32L452XX
    default "STM32L475xx" if STM32_CMSIS_MCU_STM32L475XX
    default "STM32L476xx" if STM32_CMSIS_MCU_STM32L476XX
    default "STM32L496xx" if STM32_CMSIS_MCU_STM32L496XX
    default "STM32F722xx" if STM32_CMSIS_MCU_STM32F722XX
    default "STM32F733xx" if STM32_CMSIS_MCU_STM32F733XX
    default "STM32F746xx" if STM32_CMSIS_MCU_STM32F746XX
    default "STM32F765xx" if STM32_CMSIS_MCU_STM32F765XX
    default "STM32F767xx" if STM32_CMSIS_MCU_STM32F767XX
    default "STM32F769xx" if STM32_CMSIS_MCU_STM32F769XX
    default "STM32H743xx" if STM32_CMSIS_MCU_STM32H743XX
    default "STM32WB55xx" if STM32_CMSIS_MCU_STM32WB55XX

endif # PORT_STM32
```

## ports/zephyr/boards/ai_m62_12f.conf
```kconfig
# Hardware features.
CONFIG_PINCTRL=y
CONFIG_GPIO=y

# Disable networking.
CONFIG_NETWORKING=n
CONFIG_CONSOLE_SUBSYS=y
CONFIG_CONSOLE_GETCHAR=y

# MicroPython config.
CONFIG_MICROPY_HEAP_SIZE=262144
CONFIG_WATCHDOG=n
CONFIG_MICROPY_DYNAMIC_PINCTRL=y
CONFIG_PINCTRL_DYNAMIC=y
CONFIG_MICROPY_DYNAMIC_PINCTRL_HEADER="dt-bindings/pinctrl/bl616x-pinctrl.h"
CONFIG_MICROPY_DYNAMIC_PINCTRL_REGEX="GPIO[A-Za-z0-9_]+[ 	]"
CONFIG_MICROPY_DYNAMIC_PINCTRL_GENERATE_PINMUX=y
CONFIG_MICROPY_DYNAMIC_PINCTRL_HEADER_BUILDER="dynamic_pinctrl/bflb.h"
CONFIG_CONSOLE_GETCHAR_BUFSIZE=256
```

## ports/zephyr/boards/ai_m62_12f_kit.conf
```kconfig
# Hardware features.
CONFIG_PINCTRL=y
CONFIG_GPIO=y
CONFIG_WATCHDOG=n
CONFIG_CONSOLE_SUBSYS=y
CONFIG_CONSOLE_GETCHAR=y
CONFIG_CONSOLE_GETCHAR_BUFSIZE=256
CONFIG_I2C=y
CONFIG_I2C_TARGET=y
CONFIG_SPI=y

# Disable networking.
CONFIG_NETWORKING=n

# MicroPython config.
CONFIG_MICROPY_HEAP_SIZE=262144
CONFIG_MAIN_STACK_SIZE=16384
CONFIG_MICROPY_CONFIG_ROM_LEVEL_FULL_FEATURES=y


# File System Configuration
CONFIG_FLASH=y
CONFIG_FLASH_MAP=y
CONFIG_FILE_SYSTEM=y
CONFIG_FILE_SYSTEM_LITTLEFS=y
CONFIG_FILE_SYSTEM_MKFS=y
CONFIG_MICROPY_VFS_FAT=y
CONFIG_MICROPY_VFS_LFS1=n
CONFIG_MICROPY_VFS_LFS2=n
# Default heap for littlefs is too small
CONFIG_FS_LITTLEFS_FC_HEAP_SIZE=8192
```
