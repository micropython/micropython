## Kconfig
```kconfig
mainmenu "MicroPython"

choice BUILD
    bool "Build"
    help
      Select the target program to build, either MicroPython or mpy-cross.

config BUILD_MICROPYTHON
    bool "MicroPython"

config BUILD_MPY_CROSS
    bool "mpy-cross"

endchoice

if BUILD_MICROPYTHON
rsource "ports/Kconfig"
endif

if BUILD_MPY_CROSS
rsource "mpy-cross/Kconfig"
endif

rsource "py/Kconfig"
```

## ports/Kconfig
```kconfig
choice
    bool "Port"
    default PORT_STM32
    help
      Select the MicroPython port to build.

config PORT_BARE_ARM
    bool "Generic bare-metal ARM"

config PORT_CC3200
    bool "Texas Instruments CC3200"

config PORT_ESP32
    bool "Espressif Systems ESP32"

config PORT_ESP8266
    bool "Espressif Systems ESP8266"

config PORT_JAVASCRIPT
    bool "Javascript"

config PORT_MINIMAL
    bool "Example minimal port (unix/STM32F4)"

config PORT_NRF
    bool "Nordic Semiconductor nRF"

config PORT_PIC16
    bool "Microchip PIC16"

config PORT_POWERPC
    bool "PowerPC"

config PORT_QEMU_ARM
    bool "QEMU ARM"

config PORT_SAMD
    bool "Amtel SAMD"

config PORT_STM32
    bool "STMicroelectronics STM32"

config PORT_TEENSY
    bool "PJRC Teensy"

config PORT_UNIX
    bool "Unix (Linux/macOS)"

config PORT_WINDOWS
    bool "Microsoft Windows"

config PORT_ZEPHYR
    bool "Zephyr RTOS"

endchoice

# Map port selection to directory
config PORT
    string
    default "bare-arm" if PORT_BARE_ARM
    default "cc3200" if PORT_CC3200
    default "esp32" if PORT_ESP32
    default "esp8266" if PORT_ESP8266
    default "javascript" if PORT_JAVASCRIPT
    default "minimal" if PORT_MINIMAL
    default "nrf" if PORT_NRF
    default "pic16bit" if PORT_PIC16
    default "powerpc" if PORT_POWERPC
    default "qemu-arm" if PORT_QEMU_ARM
    default "samd" if PORT_SAMD
    default "stm32" if PORT_STM32
    default "teensy" if PORT_TEENSY
    default "unix" if PORT_UNIX
    default "windows" if PORT_WINDOWS
    default "zephyr" if PORT_ZEPHYR


# include individual port Kconfig files
rsource "stm32/Kconfig"
```

## ports/esp32/boards/mch2022/Kconfig
```kconfig
menu "Firmware & device configuration"
	config INFO_FIRMWARE_NAME
		string "Code-name of the firmware"
		default "Unknown"

	config INFO_FIRMWARE_BUILD
		int "Build number of the firmware"
		default 0

	config INFO_HARDWARE_NAME
		string "Name of the device"
		default "Generic device"
		help
                A semantic name for your badge

	config MICROPY_FROZEN_MANIFEST
		string "Manifest to load modules from stored in the manifests folder"
		default "manifest.py"

	config INFO_HARDWARE_WOEZEL_NAME
		string "Name of the badge on the app hatchery"
		default "generic"

	config OTA_WEB_SERVER
		string "Hostname of server for OTA updates"
		default "badge.team"

	config OTA_WEB_USE_HTTPS
		bool "Use HTTPS for OTA updates"
		default y

	config OTA_WEB_PORT
		int "Port of server for OTA updates"
		default 443

	config OTA_WEB_PATH
		string "Path on the server for OTA updates"
		default "/firmware/unknown.bin"

	config OTA_WEB_VERSION_PATH
		string "Path on the server for OTA update version"
		default "/firmware/version/unknown.txt"

	config WOEZEL_WEB_SERVER
		string "Hostname of server for app hatchery that contains user apps"
		default "badge.team"

	config WIFI_SSID
		string "Default WiFi ssid"
		default "badge"

	config WIFI_PASSWORD
		string "Default WiFi password, leave empty for unsecure network"
		default ""
	
	choice
		prompt "Default display orientation"
		default DEFAULT_DISPLAY_ORIENTATION_LANDSCAPE
	config DEFAULT_DISPLAY_ORIENTATION_LANDSCAPE
		bool "Landscape (0 degrees)"
	config DEFAULT_DISPLAY_ORIENTATION_PORTRAIT
		bool "Portrait (90 degrees)"
	config DEFAULT_DISPLAY_ORIENTATION_REVERSE_LANDSCAPE
		bool "Reverse landscape (180 degrees)"
	config DEFAULT_DISPLAY_ORIENTATION_REVERSE_PORTRAIT
		bool "Reverse portrait (270 degrees)"
	endchoice
	
	config FW_ENABLE_SHA2017_DISOBEY2019_PARTITION_TABLE_UPGRADE
		bool "Enable partition table upgrade function for SHA2017 and Disobey 2019 badges"
		default n
	
	config FW_DISABLE_OTA_AND_FIRSTBOOT
		bool "Disable OTA update function and first boot ZIP unpacking"
		default n
endmenu
```

## ports/esp32/components/buses/Kconfig
```kconfig
menu "Buses"
    config BUS_VSPI_ENABLE
        bool "Enable the VSPI bus"
        default n

    config PIN_NUM_VSPI_CLK
        depends on BUS_VSPI_ENABLE
        int "GPIO pin used for VSPI CLK"

    config PIN_NUM_VSPI_MOSI
        depends on BUS_VSPI_ENABLE
        int "GPIO pin used for VSPI MOSI"

    config PIN_NUM_VSPI_MISO
        depends on BUS_VSPI_ENABLE
        int "GPIO pin used for VSPI MISO"

    config PIN_NUM_VSPI_WP
        depends on BUS_VSPI_ENABLE
        int "GPIO pin used for VSPI WP"
        default -1

    config PIN_NUM_VSPI_HD
        depends on BUS_VSPI_ENABLE
        int "GPIO pin used for VSPI HD"
        default -1

    config BUS_VSPI_DMA_CHANNEL
        depends on BUS_VSPI_ENABLE
        int "VSPI DMA channel"
        default 2
        range 0 2

    config BUS_VSPI_MAX_TRANSFERSIZE
        depends on BUS_VSPI_ENABLE
        int "VSPI Maximum transfer size (in bytes)"
        default 4094

    config BUS_HSPI_ENABLE
        bool "Enable the HSPI bus"
        default n

    config PIN_NUM_HSPI_CLK
        depends on BUS_HSPI_ENABLE
        int "GPIO pin used for HSPI CLK"

    config PIN_NUM_HSPI_MOSI
        depends on BUS_HSPI_ENABLE
        int "GPIO pin used for HSPI MOSI"

    config PIN_NUM_HSPI_MISO
        depends on BUS_HSPI_ENABLE
        int "GPIO pin used for HSPI MISO"

    config PIN_NUM_HSPI_WP
        depends on BUS_HSPI_ENABLE
        int "GPIO pin used for HSPI WP"
        default -1

    config PIN_NUM_HSPI_HD
        depends on BUS_HSPI_ENABLE
        int "GPIO pin used for HSPI HD"
        default -1

    config BUS_HSPI_DMA_CHANNEL
        depends on BUS_HSPI_ENABLE
        int "HSPI DMA channel"
        default 2
        range 0 2

    config BUS_HSPI_MAX_TRANSFERSIZE
        depends on BUS_HSPI_ENABLE
        int "HSPI Maximum transfer size (in bytes)"
        default 4094
        
    config BUS_I2C0_ENABLE
        bool "Enable I2C controller 0"
        default n
    
    config PIN_NUM_I2C0_DATA
        depends on BUS_I2C0_ENABLE
        int "GPIO pin used for I2C0 data"
    
    config PIN_NUM_I2C0_CLK
        depends on BUS_I2C0_ENABLE
        int "GPIO pin used for I2C0 clock"
    
    config PIN_PULL_I2C0_DATA
        depends on BUS_I2C0_ENABLE
        bool "Enable the built-in pull-up for the I2C0 data pin"
        default n
    
    config PIN_PULL_I2C0_CLK
        depends on BUS_I2C0_ENABLE
        bool "Enable the built-in pull-up for the I2C0 clock pin"
        default n
    
    config I2C0_MASTER_FREQ_HZ
        depends on BUS_I2C0_ENABLE
        int "I2C0 speed in Hz"
        default 100000

    config BUS_I2C1_ENABLE
        bool "Enable I2C controller 1"
        default n
    
    config PIN_NUM_I2C1_DATA
        depends on BUS_I2C1_ENABLE
        int "GPIO pin used for I2C1 data"
    
    config PIN_NUM_I2C1_CLK
        depends on BUS_I2C1_ENABLE
        int "GPIO pin used for I2C1 clock"
    
    config PIN_PULL_I2C1_DATA
        depends on BUS_I2C1_ENABLE
        bool "Enable the built-in pull-up for the I2C1 data pin"
        default n
    
    config PIN_PULL_I2C1_CLK
        depends on BUS_I2C1_ENABLE
        bool "Enable the built-in pull-up for the I2C1 clock pin"
        default n
    
    config I2C1_MASTER_FREQ_HZ
        depends on BUS_I2C1_ENABLE
        int "I2C1 speed in Hz"
        default 100000
endmenu
```

## ports/esp32/components/driver_badge_bsp/Kconfig
```kconfig
menu "Driver: Badge BSP display"
	config DRIVER_BADGE_BSP_ENABLE
		bool "Enable the Badge BSP display driver"
		default n
		
endmenu
```

## ports/esp32/components/driver_display_ili9341/Kconfig
```kconfig
menu "Driver: ILI9341 LCD display"
	config DRIVER_ILI9341_ENABLE
		depends on BUS_VSPI_ENABLE
		bool "Enable the ILI9341 display driver"
		default n
		
	config PIN_NUM_ILI9341_RESET
		depends on DRIVER_ILI9341_ENABLE
		int "GPIO pin used for RESET"
		default -1
	
	config PIN_NUM_ILI9341_DCX
		depends on DRIVER_ILI9341_ENABLE
		int "GPIO pin used for D/CX"
		default -1
		
	config PIN_NUM_ILI9341_CS
		depends on DRIVER_ILI9341_ENABLE
		int "GPIO pin used for CS"
		default -1
	
	config PIN_NUM_ILI9341_MODE
		depends on DRIVER_ILI9341_ENABLE
		int "GPIO pin used for mode"
		default -1

	config PIN_NUM_ILI9341_BACKLIGHT
		depends on DRIVER_ILI9341_ENABLE
		int "GPIO pin used for backlight"
		default -1
	
	config ILI9341_ORIENTATION
		depends on DRIVER_ILI9341_ENABLE
		int "Hardware orientation (0-3)"
		range 0 3
		default 0
	
	config ILI9341_COLOR_SWAP
		depends on DRIVER_ILI9341_ENABLE
		bool "Swap red and blue"
		default n
	
	config DRIVER_ILI9341_8C
		depends on DRIVER_ILI9341_ENABLE
		bool "Reduce color depth to 256 colors"
		default n
endmenu
```

## ports/esp32/components/driver_framebuffer/Kconfig
```kconfig
menu "Driver: framebuffer support"
	config DRIVER_FRAMEBUFFER_ENABLE
		bool "Enable the framebuffer driver"
		default n
	config DRIVER_FRAMEBUFFER_FLIP
		depends on DRIVER_FRAMEBUFFER_ENABLE
		bool "Flip by 180 degrees"
		default n
    config DRIVER_FRAMEBUFFER_SWAP_R_AND_B
        bool "Swap red and blue"
        default n
    config DRIVER_FRAMEBUFFER_CORRECT_GAMMA
        bool "Apply gamma correction to LED brightness values"
        default n
    config DRIVER_FRAMEBUFFER_CORRECT_GB
        bool "Correct LED brightness for green and blue channel (needed for some LEDs)"
        default n
    config DRIVER_FRAMEBUFFER_G_RATIO
		depends on DRIVER_FRAMEBUFFER_CORRECT_GB
        int "Multiply blue colour channel by (this/255) to correct for LED channel brightness"
        default 167
    config DRIVER_FRAMEBUFFER_B_RATIO
		depends on DRIVER_FRAMEBUFFER_CORRECT_GB
        int "Multiply blue colour channel by (this/255) to correct for LED channel brightness"
        default 240
	config G_MATRIX_ENABLE
		bool "Enable the matrix stack, allowing for 2D transformations"
		default n
	config MATRIX_STACK_SIZE
		depends on G_MATRIX_ENABLE
		int "Maximum size, in entries, of the matrix stack, at most 65535"
		# When empty, no memory is used for 2D matrix stacks, a single entry being 6 floats + 1 pointer or 28 bytes
		# When empty, no memory is used for 3D matrix stacks, a single entry being 12 floats + 1 pointer or 52 bytes
		default 64
		
	config G_NEW_TRIANGLE
		depends on G_MATRIX_ENABLE
		bool "Enable triangle drawing"
		default y
	config G_NEW_CIRCLE
		depends on G_NEW_TRIANGLE
		bool "Enable new circle drawing, enables matrix stack for circles and optimises circle drawing"
		default y
	config G_NEW_QUAD
		depends on G_NEW_TRIANGLE
		bool "Enable quad drawing, used also for rectangle drawing"
		default y
	config G_NEW_RECT
		depends on G_NEW_QUAD
		bool "Enable new rectangle drawing, enables matrix stack for rectangles"
		default y
	config G_NEW_TEXT
		depends on G_MATRIX_ENABLE
		bool "Enable new text drawing, enables matrix stack for text but uses more memory when transformed"
		default y

	config LIB3D_ENABLE
		depends on G_MATRIX_ENABLE
		bool "Enable 3D drawing and rendering (experimental)"
		default n
	config LIB3D_TRI_BUFFER_SIZE
		depends on LIB3D_ENABLE
		int "Triangle buffer size for 3D rendering, used for 3D rendering"
		default 32
endmenu
```

## ports/esp32/components/driver_mch22/Kconfig
```kconfig
menu "Driver: MCH2022 rp2040 driver"
	config DRIVER_MCH22_RP2040_ENABLE
		bool "Enable the mch2022 rp2040 driver"
		default n
endmenu
```

## ports/esp32/components/driver_sndmixer/Kconfig
```kconfig
menu "Driver: Audio mixer"
	config DRIVER_SNDMIXER_ENABLE
		bool "Enable the audio driver"
		default n
	
	choice
		prompt "I2S port"
		default DRIVER_SNDMIXER_I2S_PORT0
		depends on DRIVER_SNDMIXER_ENABLE
	config DRIVER_SNDMIXER_I2S_PORT0
		bool "Port 0"
	config DRIVER_SNDMIXER_I2S_PORT1
		bool "Port 1"
	endchoice
	
	choice
		prompt "I2S mode"
		default DRIVER_SNDMIXER_I2S_DAC_EXTERNAL_LSB
		depends on DRIVER_SNDMIXER_ENABLE
	config DRIVER_SNDMIXER_I2S_DAC_EXTERNAL
		bool "External I2S DAC"
	config DRIVER_SNDMIXER_I2S_DAC_EXTERNAL_MSB
		bool "External I2S DAC, MSB first"
	config DRIVER_SNDMIXER_I2S_DAC_EXTERNAL_LSB
		bool "External I2S DAC, LSB first"
	config DRIVER_SNDMIXER_I2S_DAC_INTERNAL
		depends on DRIVER_SNDMIXER_I2S_PORT0
		bool "Internal DAC"
	endchoice
	
	choice
		prompt "Internal DAC usage"
		default DRIVER_SNDMIXER_I2S_INTERNAL_DAC_BOTH
		depends on DRIVER_SNDMIXER_ENABLE && DRIVER_SNDMIXER_I2S_DAC_INTERNAL
	config DRIVER_SNDMIXER_I2S_INTERNAL_DAC_DISABLED
		bool "Disabled"
	config DRIVER_SNDMIXER_I2S_INTERNAL_DAC_RIGHT
		bool "Right enabled"
	config DRIVER_SNDMIXER_I2S_INTERNAL_DAC_LEFT
		bool "Left enabled"
	config DRIVER_SNDMIXER_I2S_INTERNAL_DAC_BOTH
		bool "Both enabled"
	endchoice
	config DRIVER_SNDMIXER_PIN_MCK
		depends on DRIVER_SNDMIXER_ENABLE && (DRIVER_SNDMIXER_I2S_DAC_EXTERNAL_MSB || DRIVER_SNDMIXER_I2S_DAC_EXTERNAL_LSB || DRIVER_SNDMIXER_I2S_DAC_EXTERNAL)
		int "GPIO to use as MCK pin"
		default -1

	config DRIVER_SNDMIXER_PIN_BCK
		depends on DRIVER_SNDMIXER_ENABLE && (DRIVER_SNDMIXER_I2S_DAC_EXTERNAL_MSB || DRIVER_SNDMIXER_I2S_DAC_EXTERNAL_LSB || DRIVER_SNDMIXER_I2S_DAC_EXTERNAL)
		int "GPIO to use as BCK pin"
	
	config DRIVER_SNDMIXER_PIN_WS
		depends on DRIVER_SNDMIXER_ENABLE && (DRIVER_SNDMIXER_I2S_DAC_EXTERNAL_MSB || DRIVER_SNDMIXER_I2S_DAC_EXTERNAL_LSB || DRIVER_SNDMIXER_I2S_DAC_EXTERNAL)
		int "GPIO to use as WS pin"
	
	config DRIVER_SNDMIXER_PIN_DATA_OUT
		depends on DRIVER_SNDMIXER_ENABLE && (DRIVER_SNDMIXER_I2S_DAC_EXTERNAL_MSB || DRIVER_SNDMIXER_I2S_DAC_EXTERNAL_LSB || DRIVER_SNDMIXER_I2S_DAC_EXTERNAL)
		int "GPIO to use as DATA OUT pin"
	
	choice
		prompt "I2S channel format"
		default DRIVER_SNDMIXER_I2S_CHANNEL_FORMAT_RL
		depends on DRIVER_SNDMIXER_ENABLE
	config DRIVER_SNDMIXER_I2S_CHANNEL_FORMAT_RL
		bool "Right, Left"
	config DRIVER_SNDMIXER_I2S_CHANNEL_FORMAT_AL
		bool "All left"
	config DRIVER_SNDMIXER_I2S_CHANNEL_FORMAT_AR
		bool "All right"
	config DRIVER_SNDMIXER_I2S_CHANNEL_FORMAT_OL
		bool "Only left"
	config DRIVER_SNDMIXER_I2S_CHANNEL_FORMAT_OR
		bool "Only Right"
	endchoice

	choice DRIVER_SNDMIXER_DATA_FORMAT
    		prompt "I2S data format"
    		default DRIVER_SNDMIXER_I2S_DATA_FORMAT_UNSIGNED
    		depends on DRIVER_SNDMIXER_ENABLE
    	config DRIVER_SNDMIXER_I2S_DATA_FORMAT_UNSIGNED
    		bool "Unsigned integers (e.g. internal DAC)"
    	config DRIVER_SNDMIXER_I2S_DATA_FORMAT_SIGNED
    		bool "(2's compliment) signed integers (most i2s DACs)"
    	endchoice
	
	config DRIVER_SNDMIXER_SAMPLE_RATE
		depends on DRIVER_SNDMIXER_ENABLE
		int "Sample rate"
		default 20000
	config DRIVER_SNDMIXER_BITS_PER_SAMPLE
		depends on DRIVER_SNDMIXER_ENABLE
		int "Bits per sample"
		default 16
	
	config DRIVER_SNDMIXER_BUFFZIE
		depends on DRIVER_SNDMIXER_ENABLE
		int "Buffer size"
		default 4096

	config DRIVER_SNDMIXER_DEBUG
		depends on DRIVER_SNDMIXER_ENABLE
		bool "Enable verbose debug messages"
		default n
endmenu
```
