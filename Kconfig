## ports/zephyr/boards/arduino_uno_q.conf
```kconfig
# Serial console (REPL) via LPUART1 → /dev/ttyHS1
CONFIG_SERIAL=y
CONFIG_CONSOLE=y
CONFIG_UART_CONSOLE=y
CONFIG_UART_INTERRUPT_DRIVEN=y

# GPIO support
CONFIG_GPIO=y

# I2C support
#   arduino_i2c / i2c2 : PB10 (SCL), PB11 (SDA) — Arduino header SDA/SCL
#   i2c4               : PD12 (SCL), PD13 (SDA) — Qwiic connector
CONFIG_I2C=y

# SPI support
#   arduino_spi / spi2 : PB13 (SCK), PB14 (MISO), PB15 (MOSI), PB9 (NSS)
CONFIG_SPI=y

# ADC support
#   adc1 channels 9/10/11/12/2/1 → Arduino pins A0-A5
CONFIG_ADC=y

# Flash and filesystem for MicroPython /flash mount
CONFIG_FLASH=y
CONFIG_FLASH_MAP=y
CONFIG_FLASH_PAGE_LAYOUT=y
CONFIG_FILE_SYSTEM=y
CONFIG_FILE_SYSTEM_LITTLEFS=y

# Stack and heap sizes for MicroPython
CONFIG_MAIN_STACK_SIZE=8192
CONFIG_SYSTEM_WORKQUEUE_STACK_SIZE=2048
CONFIG_HEAP_MEM_POOL_SIZE=16384
```

## ports/zephyr/boards/bbc_microbit_v2.conf
```kconfig
CONFIG_NETWORKING=n
CONFIG_BT=y
CONFIG_BT_DEVICE_NAME_DYNAMIC=y
CONFIG_BT_PERIPHERAL=y
CONFIG_BT_CENTRAL=y

CONFIG_MICROPY_HEAP_SIZE=98304
```

## ports/zephyr/boards/beagleconnect_freedom.conf
```kconfig
# Hardware features
CONFIG_ADC=y
CONFIG_PWM=y
CONFIG_I2C=y
CONFIG_SPI=y

# Flash drivers
CONFIG_FLASH=y
CONFIG_FLASH_MAP=y

# Disable PM
CONFIG_PM=n
CONFIG_PM_DEVICE=n
```

## ports/zephyr/boards/beagleplay_cc1352p7.conf
```kconfig
# Flash drivers
CONFIG_FLASH=y
CONFIG_FLASH_MAP=y

# Networking
CONFIG_BT=n
CONFIG_NET_IPV4=n
CONFIG_NET_CONFIG_NEED_IPV6=y
CONFIG_NET_CONFIG_NEED_IPV4=n
CONFIG_NET_CONFIG_MY_IPV4_ADDR=""
CONFIG_NET_L2_IEEE802154=y
CONFIG_NET_DHCPV4=n
CONFIG_NET_CONFIG_IEEE802154_CHANNEL=1
```

## ports/zephyr/boards/frdm_k64f.conf
```kconfig
# Networking drivers
CONFIG_NET_L2_ETHERNET=y

# Hardware features
CONFIG_I2C=y
CONFIG_SPI=y

# Sensor drivers
CONFIG_FXOS8700=y
CONFIG_FXOS8700_MODE_HYBRID=y
CONFIG_FXOS8700_TEMP=y

# Flash drivers
CONFIG_FLASH=y
CONFIG_FLASH_MAP=y
CONFIG_MPU_ALLOW_FLASH_WRITE=y
```
