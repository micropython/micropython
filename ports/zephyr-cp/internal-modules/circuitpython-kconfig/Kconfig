## ports/zephyr/boards/ai_m61_32s_kit.conf
```kconfig
# Hardware features.
CONFIG_PINCTRL=y
CONFIG_GPIO=y
CONFIG_WATCHDOG=y
CONFIG_CONSOLE_SUBSYS=y
CONFIG_CONSOLE_GETCHAR=y
CONFIG_CONSOLE_GETCHAR_BUFSIZE=1024
CONFIG_CONSOLE_PUTCHAR_BUFSIZE=1024
CONFIG_I2C=y
CONFIG_I2C_TARGET=y
CONFIG_SPI=y
CONFIG_MEMC=y
CONFIG_ENTROPY_GENERATOR=y

# Disable networking.
CONFIG_NETWORKING=n

# MicroPython config.
CONFIG_MICROPY_HEAP_SIZE=180224
CONFIG_MAIN_STACK_SIZE=16384
CONFIG_MICROPY_CONFIG_ROM_LEVEL_FULL_FEATURES=y
CONFIG_MICROPY_FROZEN_MANIFEST="boards/bflb/manifest.py"
CONFIG_MICROPY_DYNAMIC_DEVICE_INFOS=y

# Threads
CONFIG_THREAD_CUSTOM_DATA=y

# File System Configuration
CONFIG_FLASH=y
CONFIG_FLASH_MAP=y
CONFIG_FILE_SYSTEM=y
CONFIG_FILE_SYSTEM_LITTLEFS=y
CONFIG_FILE_SYSTEM_MKFS=y
CONFIG_MICROPY_VFS_FAT=y
CONFIG_MICROPY_VFS_LFS1=n
CONFIG_MICROPY_VFS_LFS2=n
# Default heap for littlefs is too small
CONFIG_FS_LITTLEFS_FC_HEAP_SIZE=8192

# Bluetooth
CONFIG_BT=y
CONFIG_BT_DEVICE_NAME_DYNAMIC=y
CONFIG_BT_DEVICE_APPEARANCE_DYNAMIC=y
CONFIG_BT_GATT_DYNAMIC_DB=y
CONFIG_BT_PERIPHERAL=y
CONFIG_BT_CENTRAL=y
CONFIG_BT_GATT_CLIENT=y
CONFIG_BT_GATT_ENFORCE_SUBSCRIPTION=n
CONFIG_BT_DIS=y
CONFIG_BT_DIS_PNP=n
CONFIG_BT_SMP=y
CONFIG_BT_BUF_ACL_RX_SIZE=672
CONFIG_BT_BUF_ACL_TX_SIZE=672
CONFIG_BT_L2CAP_TX_MTU=672
CONFIG_BT_BUF_CMD_TX_SIZE=255
CONFIG_BT_PERIPHERAL_PREF_MIN_INT=6
CONFIG_BT_HCI_TX_STACK_SIZE=2048
CONFIG_BT_RX_STACK_SIZE=4096
CONFIG_BT_BUF_ACL_TX_COUNT=8
CONFIG_BT_BUF_EVT_RX_COUNT=16

# Dynamic Pinctrl
CONFIG_MICROPY_DYNAMIC_PINCTRL=y
CONFIG_PINCTRL_DYNAMIC=y
CONFIG_MICROPY_DYNAMIC_PINCTRL_HEADER="dt-bindings/pinctrl/bl618x-pinctrl.h"
CONFIG_MICROPY_DYNAMIC_PINCTRL_REGEX="GPIO[A-Za-z0-9_]+[ 	]"
CONFIG_MICROPY_DYNAMIC_PINCTRL_GENERATE_PINMUX=y
CONFIG_MICROPY_DYNAMIC_PINCTRL_BUILDER_FILE="dynamic_pinctrl/bflb.c"
CONFIG_MICROPY_DYNAMIC_PINCTRL_GPIO_PREVIOUS_DIRECT=y
```

## ports/zephyr/boards/ai_m64p_32s_kit.conf
```kconfig
# Hardware features.
CONFIG_PINCTRL=y
CONFIG_GPIO=y
CONFIG_WATCHDOG=y
CONFIG_CONSOLE_SUBSYS=y
CONFIG_CONSOLE_GETCHAR=y
CONFIG_CONSOLE_GETCHAR_BUFSIZE=1024
CONFIG_CONSOLE_PUTCHAR_BUFSIZE=1024
CONFIG_I2C=y
CONFIG_I2C_TARGET=y
CONFIG_SPI=y
CONFIG_MEMC=y
CONFIG_ENTROPY_GENERATOR=y

# MicroPython config
CONFIG_MICROPY_HEAP_SIZE=16384
CONFIG_MAIN_STACK_SIZE=16384
CONFIG_MICROPY_CONFIG_ROM_LEVEL_FULL_FEATURES=y
CONFIG_MICROPY_FROZEN_MANIFEST="boards/bflb/manifest.py"

# Threads
CONFIG_THREAD_LOCAL_STORAGE=y

# File System Configuration
CONFIG_FLASH=y
CONFIG_FLASH_MAP=y
CONFIG_FILE_SYSTEM=y
CONFIG_FILE_SYSTEM_LITTLEFS=y
CONFIG_FILE_SYSTEM_MKFS=y
CONFIG_MICROPY_VFS_FAT=y
CONFIG_MICROPY_VFS_LFS1=n
CONFIG_MICROPY_VFS_LFS2=n
# Default heap for littlefs is too small
CONFIG_FS_LITTLEFS_FC_HEAP_SIZE=8192

# Bluetooth
CONFIG_BT=y
CONFIG_BT_DEVICE_NAME_DYNAMIC=y
CONFIG_BT_DEVICE_APPEARANCE_DYNAMIC=y
CONFIG_BT_GATT_DYNAMIC_DB=y
CONFIG_BT_PERIPHERAL=y
CONFIG_BT_CENTRAL=y
CONFIG_BT_GATT_CLIENT=y
CONFIG_BT_GATT_ENFORCE_SUBSCRIPTION=n
CONFIG_BT_DIS=y
CONFIG_BT_DIS_PNP=n
CONFIG_BT_SMP=y
CONFIG_BT_BUF_ACL_RX_SIZE=672
CONFIG_BT_BUF_ACL_TX_SIZE=672
CONFIG_BT_L2CAP_TX_MTU=672
CONFIG_BT_BUF_CMD_TX_SIZE=255
CONFIG_BT_PERIPHERAL_PREF_MIN_INT=6
CONFIG_BT_HCI_TX_STACK_SIZE=2048
CONFIG_BT_RX_STACK_SIZE=4096
CONFIG_BT_BUF_ACL_TX_COUNT=4
CONFIG_BT_BUF_EVT_RX_COUNT=5

# Networking
CONFIG_NETWORKING=y
CONFIG_WIFI=y
CONFIG_NET_IPV4=y
CONFIG_NET_IPV6=y
CONFIG_NET_UDP=y
CONFIG_NET_TCP=y
CONFIG_NET_SOCKETS=y
CONFIG_NET_HOSTNAME_DYNAMIC=y
CONFIG_WIFI_USAGE_MODE_STA_AP=y
CONFIG_NET_SOCKETS_INET_RAW=y
CONFIG_NET_SOCKETS_SOCKOPT_TLS=y
CONFIG_NET_SOCKETS_TLS_MAX_CONTEXTS=2
CONFIG_MBEDTLS_SSL_VARIABLE_BUFFER_LENGTH=y
CONFIG_MBEDTLS_SSL_IN_CONTENT_LEN=16384
CONFIG_MBEDTLS_SSL_OUT_CONTENT_LEN=16384
CONFIG_ZVFS_POLL_MAX=10
CONFIG_NET_IF_MAX_IPV6_COUNT=2
CONFIG_NET_IF_MAX_IPV4_COUNT=2

# Safeguard an amount of LIBC malloc space
CONFIG_COMMON_LIBC_MALLOC=y
CONFIG_COMMON_LIBC_MALLOC_ARENA_SIZE=16384

# DNS
CONFIG_DNS_RESOLVER=y
CONFIG_DNS_RESOLVER_AUTO_INIT=y
CONFIG_DNS_RESOLVER_ADDITIONAL_QUERIES=2
CONFIG_DNS_RESOLVER_MAX_SERVERS=2
CONFIG_NET_SOCKETS_DNS_TIMEOUT=4000

# DHCP configuration.
CONFIG_NET_DHCPV4=y
CONFIG_NET_DHCPV6=y
CONFIG_NET_DHCPV4_SERVER=y

# Use less heap than recommended, but using all of is very unlikely
CONFIG_HEAP_MEM_POOL_SIZE=45056
CONFIG_HEAP_MEM_POOL_IGNORE_MIN=y
CONFIG_SYS_HEAP_RUNTIME_STATS=y

# Required for socket.pkt_get_info()
CONFIG_NET_BUF_POOL_USAGE=y

# Fix BLE / WiFi Crypto config clash
CONFIG_MBEDTLS_PSA_P256M_DRIVER_ENABLED=n

# Don't use 40KB of RAM for nothing
CONFIG_MBEDTLS_PSA_STATIC_KEY_SLOTS=n
```

## ports/zephyr/boards/esp32c5_devkitc_hpcore.conf
```kconfig
# Hardware features.
CONFIG_FPU=n
CONFIG_PINCTRL=y
CONFIG_GPIO=y
CONFIG_WATCHDOG=y
CONFIG_CONSOLE_SUBSYS=y
CONFIG_CONSOLE_GETCHAR=y
CONFIG_CONSOLE_GETCHAR_BUFSIZE=1024
CONFIG_CONSOLE_PUTCHAR_BUFSIZE=1024
CONFIG_I2C=y
CONFIG_I2C_TARGET=y
CONFIG_SPI=y
CONFIG_ENTROPY_GENERATOR=y
CONFIG_HWINFO=y

# PSRAM
CONFIG_ESP_SPIRAM=y
CONFIG_SPIRAM_MODE_QUAD=y
CONFIG_ESPTOOLPY_FLASHFREQ_120M=y
CONFIG_SPIRAM_SPEED_120M=y

# MicroPython config
CONFIG_MICROPY_HEAP_SIZE=64
CONFIG_MAIN_STACK_SIZE=32768
CONFIG_MICROPY_CONFIG_ROM_LEVEL_FULL_FEATURES=y
CONFIG_MICROPY_FROZEN_MANIFEST="boards/espressif/manifest.py"

# File System Configuration
CONFIG_FLASH=y
CONFIG_FLASH_MAP=y
CONFIG_FILE_SYSTEM=y
CONFIG_FILE_SYSTEM_LITTLEFS=y
CONFIG_FILE_SYSTEM_MKFS=y
CONFIG_MICROPY_VFS_FAT=y
CONFIG_MICROPY_VFS_LFS1=n
CONFIG_MICROPY_VFS_LFS2=n
# Default heap for littlefs is too small
CONFIG_FS_LITTLEFS_FC_HEAP_SIZE=8192

# Bluetooth
CONFIG_BT=y
CONFIG_BT_DEVICE_NAME_DYNAMIC=y
CONFIG_BT_DEVICE_APPEARANCE_DYNAMIC=y
CONFIG_BT_GATT_DYNAMIC_DB=y
CONFIG_BT_PERIPHERAL=y
CONFIG_BT_CENTRAL=y
CONFIG_BT_GATT_CLIENT=y
CONFIG_BT_GATT_ENFORCE_SUBSCRIPTION=n
CONFIG_BT_DIS=y
CONFIG_BT_DIS_PNP=n
CONFIG_BT_SMP=y
CONFIG_BT_PERIPHERAL_PREF_MIN_INT=6

# Networking config
CONFIG_NETWORKING=y
CONFIG_WIFI=y
CONFIG_WIFI_NM=y
CONFIG_NET_L2_WIFI_MGMT=y
CONFIG_NET_IPV4=y
CONFIG_NET_IPV6=y
CONFIG_NET_UDP=y
CONFIG_NET_TCP=y
CONFIG_NET_SOCKETS=y
CONFIG_NET_HOSTNAME_ENABLE=y
CONFIG_NET_HOSTNAME_DYNAMIC=y
CONFIG_WIFI_USAGE_MODE_STA_AP=y
CONFIG_NET_SOCKETS_INET_RAW=y
CONFIG_NET_SOCKETS_SOCKOPT_TLS=y
CONFIG_NET_SOCKETS_TLS_MAX_CONTEXTS=2
CONFIG_MBEDTLS_SSL_VARIABLE_BUFFER_LENGTH=y
CONFIG_MBEDTLS_SSL_IN_CONTENT_LEN=16384
CONFIG_MBEDTLS_SSL_OUT_CONTENT_LEN=16384
CONFIG_MBEDTLS_SSL_PROTO_TLS1_2=y
CONFIG_MBEDTLS_X509_USE_C=y
CONFIG_MBEDTLS_X509_CRT_PARSE_C=y
CONFIG_MBEDTLS_PEM_PARSE_C=y
CONFIG_MBEDTLS_BASE64_C=y
CONFIG_MBEDTLS_ENTROPY_C=y
CONFIG_MBEDTLS_CIPHER=y
CONFIG_MBEDTLS_CIPHERSUITE_TLS_ECDHE_RSA_WITH_AES_128_CBC_SHA256=y
CONFIG_MBEDTLS_HASH_ALL_ENABLED=y
CONFIG_PSA_WANT_ALG_SHA_1=y
CONFIG_ZVFS_POLL_MAX=10
CONFIG_NET_IF_MAX_IPV6_COUNT=2
CONFIG_NET_IF_MAX_IPV4_COUNT=2

# Safeguard an amount of LIBC malloc space
CONFIG_COMMON_LIBC_MALLOC=y
CONFIG_COMMON_LIBC_MALLOC_ARENA_SIZE=16384

# DNS
CONFIG_DNS_RESOLVER=y
CONFIG_DNS_RESOLVER_AUTO_INIT=y
CONFIG_DNS_RESOLVER_ADDITIONAL_QUERIES=2
CONFIG_DNS_RESOLVER_MAX_SERVERS=2
CONFIG_NET_SOCKETS_DNS_TIMEOUT=4000

# DHCP configuration.
CONFIG_NET_DHCPV4=y
CONFIG_NET_DHCPV6=y
CONFIG_NET_DHCPV4_SERVER=y

# Use less heap than recommended, but using all of is very unlikely
CONFIG_HEAP_MEM_POOL_SIZE=40960
CONFIG_HEAP_MEM_POOL_IGNORE_MIN=y
CONFIG_SYS_HEAP_RUNTIME_STATS=y

# Required for socket.pkt_get_info()
CONFIG_NET_BUF_POOL_USAGE=y

# Relocate some things to PSRAM to free up SRAM
CONFIG_ESP_WIFI_HEAP_SPIRAM=y
CONFIG_ESP32_WIFI_NET_ALLOC_SPIRAM=y

# Don't use 40KB of RAM for nothing
CONFIG_MBEDTLS_PSA_STATIC_KEY_SLOTS=n

# With driver-only ECC (p256-m) the builtin ECP module is not
# built, MBEDTLS_ECP_MAX_BITS collapses to 1 and the TLS 1.2
# premaster buffer is too small for the ECDHE shared secret.
CONFIG_MBEDTLS_PSA_P256M_DRIVER_ENABLED=n

# Use external PSRAM, the area is relocated by the soc's linker script
CONFIG_MBEDTLS_ENABLE_HEAP=y
CONFIG_MBEDTLS_HEAP_CUSTOM_SECTION=y
CONFIG_MBEDTLS_HEAP_SIZE=131072
```

## ports/zephyr/boards/rpi_pico.conf
```kconfig
# Disable floating point hardware.
CONFIG_FPU=n

# Configure serial console over USB CDC ACM.
CONFIG_USB_DEVICE_STACK_NEXT=y
CONFIG_USBD_CDC_ACM_CLASS=y
CONFIG_UART_LINE_CTRL=y

# Disable networking.
CONFIG_NETWORKING=n

# Hardware features.
CONFIG_FLASH=y
CONFIG_FLASH_MAP=y
CONFIG_I2C=y
CONFIG_I2C_TARGET=y
CONFIG_SPI=y

# MicroPython config.
CONFIG_MICROPY_HEAP_SIZE=163840
CONFIG_MICROPY_CONFIG_ROM_LEVEL_FULL_FEATURES=y

# File System Configuration
CONFIG_FILE_SYSTEM=y
CONFIG_FILE_SYSTEM_LITTLEFS=y
CONFIG_FILE_SYSTEM_MKFS=y
CONFIG_MICROPY_VFS_FAT=n
CONFIG_MICROPY_VFS_LFS1=n
CONFIG_MICROPY_VFS_LFS2=n
# Default heap for littlefs is too small
CONFIG_FS_LITTLEFS_FC_HEAP_SIZE=8192

# Dynamic Pinctrl
CONFIG_MICROPY_DYNAMIC_PINCTRL=y
CONFIG_PINCTRL_DYNAMIC=y
CONFIG_PINCTRL=y
CONFIG_MICROPY_DYNAMIC_PINCTRL_HEADER="dt-bindings/pinctrl/rpi-pico-rp2040-pinctrl.h"
CONFIG_MICROPY_DYNAMIC_PINCTRL_REGEX="[ 	][A-Za-z0-9_]+_P[0-9]+[ 	]"
CONFIG_MICROPY_DYNAMIC_PINCTRL_BUILDER_FILE="dynamic_pinctrl/rpi_pico.c"
CONFIG_MICROPY_DYNAMIC_PINCTRL_GENERATE_PINMUX=y
CONFIG_MICROPY_DYNAMIC_PINCTRL_SUPPORT_ILLEGAL=y
```

## ports/zephyr/boards/rpi_pico2_rp2350a_m33.conf
```kconfig
# Configure serial console over USB CDC ACM.
CONFIG_USB_DEVICE_STACK_NEXT=y
CONFIG_USBD_CDC_ACM_CLASS=y
CONFIG_UART_LINE_CTRL=y

# Disable networking.
CONFIG_NETWORKING=n

# Hardware features.
CONFIG_FLASH=y
CONFIG_FLASH_MAP=y
CONFIG_I2C=y
CONFIG_I2C_TARGET=y
CONFIG_SPI=y

# MicroPython config.
CONFIG_MICROPY_HEAP_SIZE=458752
CONFIG_MICROPY_CONFIG_ROM_LEVEL_FULL_FEATURES=y

# Dynamic Pinctrl
CONFIG_MICROPY_DYNAMIC_PINCTRL=y
CONFIG_PINCTRL_DYNAMIC=y
CONFIG_PINCTRL=y
CONFIG_MICROPY_DYNAMIC_PINCTRL_HEADER="dt-bindings/pinctrl/rpi-pico-rp2350a-pinctrl.h"
CONFIG_MICROPY_DYNAMIC_PINCTRL_REGEX="[ 	][A-Za-z0-9_]+_P[0-9]+[ 	]"
CONFIG_MICROPY_DYNAMIC_PINCTRL_BUILDER_FILE="dynamic_pinctrl/rpi_pico.c"
CONFIG_MICROPY_DYNAMIC_PINCTRL_GENERATE_PINMUX=y
CONFIG_MICROPY_DYNAMIC_PINCTRL_SUPPORT_ILLEGAL=y

# Bugfix
CONFIG_MICROPY_CONFIGFILE="rpi_pico/rp2350.h"
```

## ports/zephyr/boards/rpi_pico2_rp2350a_m33_w.conf
```kconfig
# Hardware features.
CONFIG_PINCTRL=y
CONFIG_GPIO=y
CONFIG_WATCHDOG=y
CONFIG_CONSOLE_SUBSYS=y
CONFIG_CONSOLE_GETCHAR=y
CONFIG_CONSOLE_GETCHAR_BUFSIZE=1024
CONFIG_CONSOLE_PUTCHAR_BUFSIZE=1024
CONFIG_I2C=y
CONFIG_I2C_TARGET=y
CONFIG_SPI=y
CONFIG_ENTROPY_GENERATOR=y

# Configure serial console over USB CDC ACM.
CONFIG_USB_DEVICE_STACK_NEXT=y
CONFIG_USBD_CDC_ACM_CLASS=y
CONFIG_UART_LINE_CTRL=y

# MicroPython config.
CONFIG_MICROPY_HEAP_SIZE=270336
CONFIG_MAIN_STACK_SIZE=16384
CONFIG_MICROPY_CONFIG_ROM_LEVEL_FULL_FEATURES=y

# Threads
CONFIG_THREAD_LOCAL_STORAGE=y

# File System Configuration
CONFIG_FLASH=y
CONFIG_FLASH_MAP=y
CONFIG_FILE_SYSTEM=y
CONFIG_FILE_SYSTEM_LITTLEFS=y
CONFIG_FILE_SYSTEM_MKFS=y
CONFIG_MICROPY_VFS_FAT=y
CONFIG_MICROPY_VFS_LFS1=n
CONFIG_MICROPY_VFS_LFS2=n
# Default heap for littlefs is too small
CONFIG_FS_LITTLEFS_FC_HEAP_SIZE=8192

# Networking
CONFIG_NETWORKING=y
CONFIG_WIFI=y
CONFIG_WIFI_NM=y
CONFIG_NET_L2_WIFI_MGMT=y
CONFIG_NET_IPV4=y
CONFIG_NET_IPV6=y
CONFIG_NET_UDP=y
CONFIG_NET_TCP=y
CONFIG_NET_SOCKETS=y
CONFIG_NET_HOSTNAME_ENABLE=y
CONFIG_NET_HOSTNAME_DYNAMIC=y
CONFIG_WIFI_USAGE_MODE_STA=y
CONFIG_NET_SOCKETS_INET_RAW=y
CONFIG_NET_SOCKETS_SOCKOPT_TLS=y
CONFIG_NET_SOCKETS_TLS_MAX_CONTEXTS=2
CONFIG_MBEDTLS_SSL_PROTO_TLS1_2=y
CONFIG_MBEDTLS_X509_USE_C=y
CONFIG_MBEDTLS_X509_CRT_PARSE_C=y
CONFIG_MBEDTLS_PEM_PARSE_C=y
CONFIG_MBEDTLS_BASE64_C=y
CONFIG_MBEDTLS_ENTROPY_C=y
CONFIG_MBEDTLS_CIPHER=y
CONFIG_MBEDTLS_CIPHERSUITE_TLS_ECDHE_RSA_WITH_AES_128_CBC_SHA256=y
CONFIG_MBEDTLS_HASH_ALL_ENABLED=y
CONFIG_PSA_WANT_ALG_SHA_1=y
CONFIG_ZVFS_POLL_MAX=10
CONFIG_NET_IF_MAX_IPV6_COUNT=2
CONFIG_NET_IF_MAX_IPV4_COUNT=2

# TLS buffers
CONFIG_COMMON_LIBC_MALLOC=y
CONFIG_COMMON_LIBC_MALLOC_ARENA_SIZE=49152
CONFIG_MBEDTLS_SSL_VARIABLE_BUFFER_LENGTH=y
CONFIG_MBEDTLS_SSL_IN_CONTENT_LEN=16384
CONFIG_MBEDTLS_SSL_OUT_CONTENT_LEN=8192

# DNS
CONFIG_DNS_RESOLVER=y
CONFIG_DNS_RESOLVER_AUTO_INIT=y
CONFIG_DNS_RESOLVER_ADDITIONAL_QUERIES=2
CONFIG_DNS_RESOLVER_MAX_SERVERS=2
CONFIG_NET_SOCKETS_DNS_TIMEOUT=4000

# DHCP configuration.
CONFIG_NET_DHCPV4=y
CONFIG_NET_DHCPV6=y
CONFIG_NET_DHCPV4_SERVER=y

# Heap
CONFIG_HEAP_MEM_POOL_SIZE=32768
CONFIG_SYS_HEAP_RUNTIME_STATS=y

# Required for socket.pkt_get_info()
CONFIG_NET_BUF_POOL_USAGE=y

# With driver-only ECC (p256-m) the builtin ECP module is not
# built, MBEDTLS_ECP_MAX_BITS collapses to 1 and the TLS 1.2
# premaster buffer is too small for the ECDHE shared secret.
CONFIG_MBEDTLS_PSA_P256M_DRIVER_ENABLED=n

# Don't use 40KB of RAM for nothing
CONFIG_MBEDTLS_PSA_STATIC_KEY_SLOTS=n
```

## ports/zephyr/dts/bindings/micropython/zephyr,heap.yaml
```yaml
# Copyright (c) 2026 MASSDRIVER EI (massdriver.space)
# SPDX-License-Identifier: Apache-2.0

title: Zephyr Heap

description: |
    Used to define a Zephyr heap area.

compatible: "zephyr,heap"

include: [base.yaml]

properties:
  size:
    type: int
    required: true
    description: |
      Size of the heap

  memory-region:
    type: phandle
    required: true
    description: |
      Memory region to place the heap in
```
