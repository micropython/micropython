// The contents of this file is semi-automatically generated. It has two sections, the first has
// libc functions and the second has ESP-IDF functions, all of which are made available to
// dynamically loaded native modules.
// The order of functions matters! Changing the order breaks comaptibility!
// To add functions to the end, run make -f port_fun.mk, then see what's new (in port_fun_new.inc)
// and manually copy the desired functions over.
//
//
// First section:
// List of libc entry points that are already linked into MP for inclusion into mp_port_fun_table
// Obtained using something like:
// xtensa-esp32-elf-nm --extern-only build-GENERIC/application.elf | grep ' A ' |
//     sed -e 's/^.* [TA] //' | sort -u >externs-mp
// <same command on find ~/.espressif/tools/xtensa-esp32-elf/ -name libc.a>
// sort externs-libc1 externs-mp1 | uniq -c | egrep ' 2 ' | egrep -v ' _' | sed -e 's/.* //' >libc.inc
abs,
asctime,
asctime_r,
atoi,
atol,
bzero,
creat,
ctime,
ctime_r,
div,
fclose,
fflush,
fputwc,
gmtime,
gmtime_r,
isalnum,
isalpha,
isascii,
isblank,
iscntrl,
isdigit,
isgraph,
islower,
isprint,
ispunct,
isspace,
isupper,
itoa,
labs,
ldiv,
localeconv,
localtime,
localtime_r,
longjmp,
memccpy,
memchr,
memcmp,
memcpy,
memmove,
memrchr,
memset,
mktime,
qsort,
rand,
rand_r,
setjmp,
setlocale,
settimeofday,
srand,
strcasecmp,
strcasestr,
strcat,
strchr,
strcmp,
strcoll,
strcpy,
strcspn,
strdup,
strftime,
strlcat,
strlcpy,
strlen,
strlwr,
strncasecmp,
strncat,
strncmp,
strncpy,
strndup,
strnlen,
strrchr,
strsep,
strspn,
strstr,
strtok_r,
strtol,
strtoul,
strupr,
time,
toascii,
tolower,
toupper,
tzset,
ungetc,
utoa,
wcrtomb,
//
// Second section:
// List of ESP-IDF entry points culled from portions of the docs.
// Initially generated for ESP-IDF v4.0 release using 'port_fun' target in Makefile.
// Use that Makefile target to add new functions to the end of the list.
adc1_config_channel_atten,
adc1_config_width,
adc1_get_raw,
adc1_pad_get_io_num,
adc1_ulp_enable,
adc2_config_channel_atten,
adc2_get_raw,
adc2_pad_get_io_num,
adc2_vref_to_gpio,
adc_gpio_init,
adc_i2s_mode_init,
adc_power_off,
adc_power_on,
adc_set_clk_div,
adc_set_data_inv,
adc_set_data_width,
adc_set_i2s_data_source,
can_clear_receive_queue,
can_clear_transmit_queue,
can_driver_install,
can_driver_uninstall,
can_get_status_info,
can_initiate_recovery,
can_read_alerts,
can_receive,
can_reconfigure_alerts,
can_start,
can_stop,
can_transmit,
dac_i2s_disable,
dac_i2s_enable,
dac_output_disable,
dac_output_enable,
dac_output_voltage,
dac_pad_get_io_num,
esp_base_mac_addr_get,
esp_base_mac_addr_set,
esp_chip_info,
esp_deep_sleep,
esp_deep_sleep_disable_rom_logging,
esp_deep_sleep_start,
esp_default_wake_deep_sleep,
esp_deregister_freertos_idle_hook,
esp_deregister_freertos_idle_hook_for_cpu,
esp_deregister_freertos_tick_hook,
esp_deregister_freertos_tick_hook_for_cpu,
esp_derive_local_mac,
esp_efuse_apply_34_encoding,
esp_efuse_burn_new_values,
esp_efuse_check_secure_version,
esp_efuse_disable_basic_rom_console,
esp_efuse_get_chip_ver,
esp_efuse_get_coding_scheme,
esp_efuse_get_field_size,
esp_efuse_get_pkg_ver,
esp_efuse_mac_get_custom,
esp_efuse_mac_get_default,
esp_efuse_read_block,
esp_efuse_read_field_blob,
esp_efuse_read_field_cnt,
esp_efuse_read_reg,
esp_efuse_read_secure_version,
esp_efuse_reset,
esp_efuse_set_read_protect,
esp_efuse_set_write_protect,
esp_efuse_update_secure_version,
esp_efuse_write_block,
esp_efuse_write_field_blob,
esp_efuse_write_field_cnt,
esp_efuse_write_random_key,
esp_efuse_write_reg,
esp_err_to_name,
esp_err_to_name_r,
esp_fill_random,
esp_flash_encryption_init_checks,
esp_flash_write_protect_crypt_cnt,
esp_get_deep_sleep_wake_stub,
esp_get_flash_encryption_mode,
esp_get_free_heap_size,
esp_get_idf_version,
esp_get_minimum_free_heap_size,
esp_intr_alloc,
esp_intr_alloc_intrstatus,
esp_intr_disable,
esp_intr_enable,
esp_intr_free,
esp_intr_get_cpu,
esp_intr_get_intno,
esp_intr_mark_shared,
esp_intr_noniram_disable,
esp_intr_noniram_enable,
esp_intr_reserve,
esp_intr_set_in_iram,
esp_int_wdt_cpu_init,
esp_int_wdt_init,
esp_ipc_call,
esp_ipc_call_blocking,
esp_light_sleep_start,
esp_ota_begin,
esp_ota_check_rollback_is_possible,
esp_ota_end,
esp_ota_erase_last_boot_app_partition,
esp_ota_get_app_description,
esp_ota_get_app_elf_sha256,
esp_ota_get_boot_partition,
esp_ota_get_last_invalid_partition,
esp_ota_get_next_update_partition,
esp_ota_get_partition_description,
esp_ota_get_running_partition,
esp_ota_get_state_partition,
esp_ota_mark_app_invalid_rollback_and_reboot,
esp_ota_mark_app_valid_cancel_rollback,
esp_ota_set_boot_partition,
esp_ota_write,
esp_pm_configure,
esp_pm_dump_locks,
esp_pm_lock_acquire,
esp_pm_lock_create,
esp_pm_lock_delete,
esp_pm_lock_release,
esp_random,
esp_read_mac,
esp_register_freertos_idle_hook,
esp_register_freertos_idle_hook_for_cpu,
esp_register_freertos_tick_hook,
esp_register_freertos_tick_hook_for_cpu,
esp_register_shutdown_handler,
esp_reset_reason,
esp_restart,
esp_set_deep_sleep_wake_stub,
esp_sleep_disable_wakeup_source,
esp_sleep_enable_ext0_wakeup,
esp_sleep_enable_ext1_wakeup,
esp_sleep_enable_gpio_wakeup,
esp_sleep_enable_timer_wakeup,
esp_sleep_enable_touchpad_wakeup,
esp_sleep_enable_uart_wakeup,
esp_sleep_enable_ulp_wakeup,
esp_sleep_get_ext1_wakeup_status,
esp_sleep_get_touchpad_wakeup_status,
esp_sleep_get_wakeup_cause,
esp_sleep_pd_config,
esp_task_wdt_add,
esp_task_wdt_deinit,
esp_task_wdt_delete,
esp_task_wdt_init,
esp_task_wdt_reset,
esp_task_wdt_status,
esp_timer_create,
esp_timer_deinit,
esp_timer_delete,
esp_timer_dump,
esp_timer_get_next_alarm,
esp_timer_get_time,
esp_timer_init,
esp_timer_start_once,
esp_timer_start_periodic,
esp_timer_stop,
esp_unregister_shutdown_handler,
esp_wifi_deinit,
esp_wifi_init,
gpio_config,
gpio_deep_sleep_hold_dis,
gpio_deep_sleep_hold_en,
gpio_get_drive_capability,
gpio_get_level,
gpio_hold_dis,
gpio_hold_en,
gpio_install_isr_service,
gpio_intr_disable,
gpio_intr_enable,
gpio_iomux_in,
gpio_iomux_out,
gpio_isr_handler_add,
gpio_isr_handler_remove,
gpio_isr_register,
gpio_pulldown_dis,
gpio_pulldown_en,
gpio_pullup_dis,
gpio_pullup_en,
gpio_reset_pin,
gpio_set_direction,
gpio_set_drive_capability,
gpio_set_intr_type,
gpio_set_level,
gpio_set_pull_mode,
gpio_uninstall_isr_service,
gpio_wakeup_disable,
gpio_wakeup_enable,
hall_sensor_read,
i2c_cmd_link_create,
i2c_cmd_link_delete,
i2c_driver_delete,
i2c_driver_install,
i2c_filter_disable,
i2c_filter_enable,
i2c_get_data_mode,
i2c_get_data_timing,
i2c_get_period,
i2c_get_start_timing,
i2c_get_stop_timing,
i2c_get_timeout,
i2c_isr_free,
i2c_isr_register,
i2c_master_cmd_begin,
i2c_master_read,
i2c_master_read_byte,
i2c_master_start,
i2c_master_stop,
i2c_master_write,
i2c_master_write_byte,
i2c_param_config,
i2c_reset_rx_fifo,
i2c_reset_tx_fifo,
i2c_set_data_mode,
i2c_set_data_timing,
i2c_set_period,
i2c_set_pin,
i2c_set_start_timing,
i2c_set_stop_timing,
i2c_set_timeout,
i2c_slave_read_buffer,
i2c_slave_write_buffer,
i2s_adc_disable,
i2s_adc_enable,
i2s_driver_install,
i2s_driver_uninstall,
i2s_get_clk,
i2s_read,
i2s_set_adc_mode,
i2s_set_clk,
i2s_set_dac_mode,
i2s_set_pdm_rx_down_sample,
i2s_set_pin,
i2s_set_sample_rates,
i2s_start,
i2s_stop,
i2s_write,
i2s_write_expand,
i2s_zero_dma_buffer,
ledc_bind_channel_timer,
ledc_channel_config,
ledc_fade_func_install,
ledc_fade_func_uninstall,
ledc_fade_start,
ledc_get_duty,
ledc_get_freq,
ledc_get_hpoint,
ledc_isr_register,
ledc_set_duty,
ledc_set_duty_and_update,
ledc_set_duty_with_hpoint,
ledc_set_fade,
ledc_set_fade_step_and_start,
ledc_set_fade_time_and_start,
ledc_set_fade_with_step,
ledc_set_fade_with_time,
ledc_set_freq,
ledc_stop,
ledc_timer_config,
ledc_timer_pause,
ledc_timer_resume,
ledc_timer_rst,
ledc_timer_set,
ledc_update_duty,
mcpwm_capture_disable,
mcpwm_capture_enable,
mcpwm_capture_signal_get_edge,
mcpwm_capture_signal_get_value,
mcpwm_carrier_disable,
mcpwm_carrier_enable,
mcpwm_carrier_init,
mcpwm_carrier_oneshot_mode_disable,
mcpwm_carrier_oneshot_mode_enable,
mcpwm_carrier_output_invert,
mcpwm_carrier_set_duty_cycle,
mcpwm_carrier_set_period,
mcpwm_deadtime_disable,
mcpwm_deadtime_enable,
mcpwm_fault_deinit,
mcpwm_fault_init,
mcpwm_fault_set_cyc_mode,
mcpwm_fault_set_oneshot_mode,
mcpwm_get_duty,
mcpwm_get_frequency,
mcpwm_gpio_init,
mcpwm_init,
mcpwm_isr_register,
mcpwm_set_duty,
mcpwm_set_duty_in_us,
mcpwm_set_duty_type,
mcpwm_set_frequency,
mcpwm_set_pin,
mcpwm_set_signal_high,
mcpwm_set_signal_low,
mcpwm_start,
mcpwm_stop,
mcpwm_sync_disable,
mcpwm_sync_enable,
mdns_free,
mdns_handle_system_event,
mdns_hostname_set,
mdns_init,
mdns_instance_name_set,
mdns_query,
mdns_query_a,
mdns_query_aaaa,
mdns_query_ptr,
mdns_query_results_free,
mdns_query_srv,
mdns_query_txt,
mdns_service_add,
mdns_service_instance_name_set,
mdns_service_port_set,
mdns_service_remove,
mdns_service_remove_all,
mdns_service_txt_item_remove,
mdns_service_txt_item_set,
mdns_service_txt_set,
nvs_close,
nvs_commit,
nvs_entry_find,
nvs_entry_info,
nvs_entry_next,
nvs_erase_all,
nvs_erase_key,
nvs_flash_deinit,
nvs_flash_deinit_partition,
nvs_flash_erase,
nvs_flash_erase_partition,
nvs_flash_init,
nvs_flash_init_partition,
nvs_get_blob,
nvs_get_i16,
nvs_get_i32,
nvs_get_i64,
nvs_get_i8,
nvs_get_stats,
nvs_get_str,
nvs_get_u16,
nvs_get_u32,
nvs_get_u64,
nvs_get_u8,
nvs_get_used_entry_count,
nvs_open,
nvs_open_from_partition,
nvs_release_iterator,
nvs_set_blob,
nvs_set_i16,
nvs_set_i32,
nvs_set_i64,
nvs_set_i8,
nvs_set_str,
nvs_set_u16,
nvs_set_u32,
nvs_set_u64,
nvs_set_u8,
pcnt_counter_clear,
pcnt_counter_pause,
pcnt_counter_resume,
pcnt_event_disable,
pcnt_event_enable,
pcnt_filter_disable,
pcnt_filter_enable,
pcnt_get_counter_value,
pcnt_get_event_value,
pcnt_get_filter_value,
pcnt_intr_disable,
pcnt_intr_enable,
pcnt_isr_handler_add,
pcnt_isr_handler_remove,
pcnt_isr_register,
pcnt_isr_service_install,
pcnt_isr_service_uninstall,
pcnt_set_event_value,
pcnt_set_filter_value,
pcnt_set_mode,
pcnt_set_pin,
pcnt_unit_config,
pcTimerGetTimerName,
pvTimerGetTimerID,
rmt_clr_intr_enable_mask,
rmt_config,
rmt_driver_install,
rmt_driver_uninstall,
rmt_fill_tx_items,
rmt_get_channel_status,
rmt_get_clk_div,
rmt_get_idle_level,
rmt_get_mem_block_num,
rmt_get_memory_owner,
rmt_get_mem_pd,
rmt_get_ringbuf_handle,
rmt_get_rx_idle_thresh,
rmt_get_source_clk,
rmt_get_status,
rmt_get_tx_loop_mode,
rmt_isr_deregister,
rmt_isr_register,
rmt_memory_rw_rst,
rmt_register_tx_end_callback,
rmt_rx_start,
rmt_rx_stop,
rmt_set_clk_div,
rmt_set_err_intr_en,
rmt_set_idle_level,
rmt_set_intr_enable_mask,
rmt_set_mem_block_num,
rmt_set_memory_owner,
rmt_set_mem_pd,
rmt_set_pin,
rmt_set_rx_filter,
rmt_set_rx_idle_thresh,
rmt_set_rx_intr_en,
rmt_set_source_clk,
rmt_set_tx_carrier,
rmt_set_tx_intr_en,
rmt_set_tx_loop_mode,
rmt_set_tx_thr_intr_en,
rmt_translator_init,
rmt_tx_start,
rmt_tx_stop,
rmt_wait_tx_done,
rmt_write_items,
rmt_write_sample,
rtc_gpio_deinit,
rtc_gpio_force_hold_dis_all,
rtc_gpio_get_drive_capability,
rtc_gpio_get_level,
rtc_gpio_hold_dis,
rtc_gpio_hold_en,
rtc_gpio_init,
rtc_gpio_isolate,
rtc_gpio_pulldown_dis,
rtc_gpio_pulldown_en,
rtc_gpio_pullup_dis,
rtc_gpio_pullup_en,
rtc_gpio_set_direction,
rtc_gpio_set_drive_capability,
rtc_gpio_set_level,
rtc_gpio_wakeup_disable,
rtc_gpio_wakeup_enable,
sdio_slave_clear_host_int,
sdio_slave_deinit,
sdio_slave_get_host_intena,
sdio_slave_initialize,
sdio_slave_read_reg,
sdio_slave_recv,
sdio_slave_recv_get_buf,
sdio_slave_recv_load_buf,
sdio_slave_recv_register_buf,
sdio_slave_recv_unregister_buf,
sdio_slave_reset,
sdio_slave_send_get_finished,
sdio_slave_send_host_int,
sdio_slave_send_queue,
sdio_slave_set_host_intena,
sdio_slave_start,
sdio_slave_stop,
sdio_slave_transmit,
sdio_slave_wait_int,
sdio_slave_write_reg,
sdmmc_card_init,
sdmmc_card_print_info,
sdmmc_host_deinit,
sdmmc_host_do_transaction,
sdmmc_host_get_slot_width,
sdmmc_host_init,
sdmmc_host_init_slot,
sdmmc_host_io_int_enable,
sdmmc_host_io_int_wait,
sdmmc_host_pullup_en,
sdmmc_host_set_bus_ddr_mode,
sdmmc_host_set_bus_width,
sdmmc_host_set_card_clk,
sdmmc_io_enable_int,
sdmmc_io_get_cis_data,
sdmmc_io_print_cis_info,
sdmmc_io_read_blocks,
sdmmc_io_read_byte,
sdmmc_io_read_bytes,
sdmmc_io_wait_int,
sdmmc_io_write_blocks,
sdmmc_io_write_byte,
sdmmc_io_write_bytes,
sdmmc_read_sectors,
sdmmc_write_sectors,
sdspi_host_deinit,
sdspi_host_do_transaction,
sdspi_host_init,
sdspi_host_init_slot,
sdspi_host_io_int_enable,
sdspi_host_io_int_wait,
sdspi_host_set_card_clk,
sigmadelta_config,
sigmadelta_set_duty,
sigmadelta_set_pin,
sigmadelta_set_prescale,
spi_bus_free,
spi_bus_initialize,
timer_disable_intr,
timer_enable_intr,
timer_get_alarm_value,
timer_get_config,
timer_get_counter_time_sec,
timer_get_counter_value,
timer_group_intr_disable,
timer_group_intr_enable,
timer_init,
timer_isr_register,
timer_pause,
timer_set_alarm,
timer_set_alarm_value,
timer_set_auto_reload,
timer_set_counter_mode,
timer_set_counter_value,
timer_set_divider,
timer_start,
uart_clear_intr_status,
uart_disable_intr_mask,
uart_disable_pattern_det_intr,
uart_disable_rx_intr,
uart_disable_tx_intr,
uart_driver_delete,
uart_driver_install,
uart_enable_intr_mask,
uart_enable_pattern_det_intr,
uart_enable_rx_intr,
uart_enable_tx_intr,
uart_flush,
uart_flush_input,
uart_get_baudrate,
uart_get_buffered_data_len,
uart_get_collision_flag,
uart_get_hw_flow_ctrl,
uart_get_parity,
uart_get_stop_bits,
uart_get_wakeup_threshold,
uart_get_word_length,
uart_intr_config,
uart_isr_free,
uart_isr_register,
uart_param_config,
uart_pattern_get_pos,
uart_pattern_pop_pos,
uart_pattern_queue_reset,
uart_read_bytes,
uart_set_baudrate,
uart_set_dtr,
uart_set_hw_flow_ctrl,
uart_set_line_inverse,
uart_set_mode,
uart_set_parity,
uart_set_pin,
uart_set_rts,
uart_set_rx_timeout,
uart_set_stop_bits,
uart_set_sw_flow_ctrl,
uart_set_tx_idle_num,
uart_set_wakeup_threshold,
uart_set_word_length,
uart_tx_chars,
uart_wait_tx_done,
uart_write_bytes,
uart_write_bytes_with_break,
ulp_load_binary,
ulp_process_macros_and_load,
ulp_run,
ulp_set_wakeup_period,
vTimerSetTimerID,
xTimerCreate,
xTimerCreateStatic,
xTimerGetExpiryTime,
xTimerGetPeriod,
xTimerIsTimerActive,
xTimerPendFunctionCall,
xTimerPendFunctionCallFromISR,
