## ports/zephyr/boards/lpcxpresso55s69_cpu0.conf
```kconfig
# Copyright 2023 NXP
# SPDX-License-Identifier: Apache-2.0

# CONFIG_MAIN_STACK_SIZE=2048

CONFIG_NETWORKING=n
CONFIG_BT=n

CONFIG_FLASH=y
CONFIG_FLASH_MAP=y
# CONFIG_FLASH_PAGE_LAYOUT=y
CONFIG_MPU_ALLOW_FLASH_WRITE=y

# MICROPY_VFS=y

# CONFIG_FILE_SYSTEM=y
# CONFIG_FILE_SYSTEM_LITTLEFS=y

CONFIG_FS_LITTLEFS_PROG_SIZE=512
CONFIG_FS_LITTLEFS_CACHE_SIZE=512
```

## ports/zephyr/boards/m0sense.conf
```kconfig
# Hardware features.
CONFIG_PINCTRL=y
CONFIG_GPIO=y
CONFIG_WATCHDOG=y
CONFIG_I2C=y
CONFIG_I2C_TARGET=n
CONFIG_SPI=y
CONFIG_ENTROPY_GENERATOR=y

# Disable networking.
CONFIG_NETWORKING=n

# MicroPython config.
CONFIG_MICROPY_HEAP_SIZE=17500
CONFIG_MAIN_STACK_SIZE=8192
CONFIG_MICROPY_CONFIG_ROM_LEVEL_BASIC_FEATURES=y
CONFIG_MICROPY_CONFIGFILE="boards/bflb/BL70xA0.h"

# File System Configuration
CONFIG_FLASH=y
CONFIG_FLASH_MAP=y
CONFIG_FILE_SYSTEM=y
CONFIG_FILE_SYSTEM_LITTLEFS=y
CONFIG_FILE_SYSTEM_MKFS=y
CONFIG_MICROPY_VFS_FAT=n
CONFIG_MICROPY_VFS_LFS1=n
CONFIG_MICROPY_VFS_LFS2=n
# Default heap for littlefs is too small
CONFIG_FS_LITTLEFS_FC_HEAP_SIZE=4096

# Console Configuration
CONFIG_CONSOLE_SUBSYS=y
CONFIG_UART_CONSOLE=y
CONFIG_CONSOLE_GETCHAR=y
CONFIG_CONSOLE_GETCHAR_BUFSIZE=512
CONFIG_CONSOLE_PUTCHAR_BUFSIZE=128

# BLE
CONFIG_BT=y
CONFIG_BT_DEVICE_NAME_DYNAMIC=y
CONFIG_BT_DEVICE_APPEARANCE_DYNAMIC=y
CONFIG_BT_GATT_DYNAMIC_DB=y
CONFIG_BT_PERIPHERAL=y
CONFIG_BT_CENTRAL=n
CONFIG_BT_GATT_CLIENT=n
CONFIG_BT_DIS=n
CONFIG_BT_DIS_PNP=n
CONFIG_BT_BUF_ACL_RX_SIZE=256
CONFIG_BT_BUF_ACL_TX_SIZE=256
CONFIG_BT_L2CAP_TX_MTU=256
CONFIG_BT_BUF_CMD_TX_SIZE=255
CONFIG_BT_PERIPHERAL_PREF_MIN_INT=6
CONFIG_BT_BUF_ACL_TX_COUNT=2
CONFIG_BT_BUF_EVT_RX_COUNT=4

# We have entropy
CONFIG_TEST_RANDOM_GENERATOR=n
```

## ports/zephyr/boards/mimxrt1020_evk.conf
```kconfig
CONFIG_USB_DEVICE_STACK=y
CONFIG_USB_DEVICE_PRODUCT="Zephyr MicroPython"
CONFIG_USB_MASS_STORAGE=y
CONFIG_MASS_STORAGE_DISK_NAME="SDMMC"

CONFIG_FLASH=y
CONFIG_FLASH_MAP=y
CONFIG_FLASH_PAGE_LAYOUT=y

CONFIG_MICROPY_FROZEN_MODULES=y
CONFIG_MICROPY_FROZEN_MANIFEST="boards/mimxrt1020_evk/manifest.py"
CONFIG_MICROPY_CONFIGFILE="boards/mimxrt1020_evk/mpconfigport.h"

# CONFIG_DYNAMIC_THREAD=y
CONFIG_THREAD_CUSTOM_DATA=y
CONFIG_THREAD_MONITOR=y
CONFIG_THREAD_STACK_INFO=y

CONFIG_LOG=n
CONFIG_FP16=n
CONFIG_BOOT_BANNER=n
```

## ports/zephyr/boards/mimxrt1050_evk.conf
```kconfig
# Required for zephyr.DiskAccess block devices
CONFIG_DISK_ACCESS=y

CONFIG_USB=y
CONFIG_USB_DEVICE_STACK=y
CONFIG_USB_DEVICE_PRODUCT="Zephyr MicroPython"
CONFIG_USB_MASS_STORAGE=y
CONFIG_MASS_STORAGE_DISK_NAME="SDMMC"

CONFIG_DISPLAY_MCUX_ELCDIF=y
CONFIG_DISPLAY=y
CONFIG_MCUX_ELCDIF_PANEL_RK043FN02H=y
CONFIG_KSCAN=y
CONFIG_KSCAN_FT5336=y
```

## ports/zephyr/boards/nrf52840dk_nrf52840.conf
```kconfig
CONFIG_NETWORKING=n
CONFIG_BT=y
CONFIG_BT_DEVICE_NAME_DYNAMIC=y
CONFIG_BT_GATT_DYNAMIC_DB=y
CONFIG_BT_PERIPHERAL=y
CONFIG_BT_CENTRAL=y
CONFIG_BT_GATT_CLIENT=y
CONFIG_BT_L2CAP_TX_MTU=252
CONFIG_BT_BUF_ACL_RX_SIZE=256
CONFIG_BT_GATT_ENFORCE_SUBSCRIPTION=n

CONFIG_MICROPY_HEAP_SIZE=98304
CONFIG_MAIN_STACK_SIZE=8192

# CONFIG_DYNAMIC_THREAD=y
CONFIG_THREAD_CUSTOM_DATA=y
CONFIG_THREAD_MONITOR=y
CONFIG_THREAD_STACK_INFO=y
```

## ports/zephyr/boards/nrf9151dk_nrf9151.conf
```kconfig
# Enable external flash
CONFIG_SPI=y
CONFIG_SPI_NOR=y
CONFIG_SPI_NOR_SFDP_DEVICETREE=y

CONFIG_FLASH=y
CONFIG_FLASH_MAP=y
```

## ports/zephyr/boards/nucleo_wb55rg.conf
```kconfig
CONFIG_NETWORKING=n

# Hardware features
CONFIG_FLASH=y
CONFIG_FLASH_MAP=y
CONFIG_I2C=y
CONFIG_I2C_TARGET=y
CONFIG_SPI=y

# Bluetooth
CONFIG_BT=y
CONFIG_BT_DEVICE_NAME_DYNAMIC=y
CONFIG_BT_GATT_DYNAMIC_DB=y
CONFIG_BT_PERIPHERAL=y
CONFIG_BT_CENTRAL=y
CONFIG_BT_GATT_CLIENT=y
CONFIG_BT_L2CAP_TX_MTU=252
CONFIG_BT_BUF_ACL_RX_SIZE=256
CONFIG_BT_GATT_ENFORCE_SUBSCRIPTION=n

# MicroPython config
CONFIG_MICROPY_HEAP_SIZE=131072
```

## ports/zephyr/boards/pocketbeagle_2_am6254_m4.conf
```kconfig
# Disable Networking
CONFIG_NETWORKING=n
CONFIG_NET_IPV4=n
CONFIG_NET_IPV6=n
CONFIG_NET_UDP=n
CONFIG_NET_TCP=n
CONFIG_NET_SOCKETS=n
CONFIG_TEST_RANDOM_GENERATOR=n

CONFIG_NET_CONFIG_SETTINGS=n
CONFIG_NET_CONFIG_NEED_IPV6=n
CONFIG_NET_CONFIG_NEED_IPV4=n

CONFIG_DNS_RESOLVER=n
CONFIG_DNS_SERVER1=""
CONFIG_DNS_SERVER_IP_ADDRESSES=n

CONFIG_NET_BUF_POOL_USAGE=n
CONFIG_NET_DHCPV4=n

CONFIG_NET_CONFIG_MY_IPV6_ADDR=""
CONFIG_NET_CONFIG_MY_IPV4_ADDR=""
CONFIG_NET_CONFIG_MY_IPV4_GW=""

# Disable FAT support. Does not fit
CONFIG_MICROPY_VFS_FAT=n

# Only elf output is used
CONFIG_BUILD_OUTPUT_BIN=n
CONFIG_BUILD_OUTPUT_HEX=n
```

## ports/zephyr/boards/qemu_cortex_m3.conf
```kconfig
# Interrupt-driven UART console has emulation artifacts under QEMU,
# disable it
CONFIG_CONSOLE_SUBSYS=n

# This QEMU target only has 256k ROM and 64k RAM, so disable networking
CONFIG_NETWORKING=n

# QEMU doesn't have a watchdog, so disable it
CONFIG_WATCHDOG=n
CONFIG_WDT_DISABLE_AT_BOOT=n
```

## ports/zephyr/boards/qemu_x86.conf
```kconfig
# Networking drivers
# SLIP driver for QEMU
CONFIG_NET_SLIP_TAP=y

# QEMU doesn't have a watchdog, so disable it
CONFIG_WATCHDOG=n
CONFIG_WDT_DISABLE_AT_BOOT=n
```

## ports/zephyr/boards/xiao_ble_nrf52840_sense.conf
```kconfig
# Kconfig configuration for Seeed Studio's XIAO nRF52840 Sense

CONFIG_NETWORKING=n
CONFIG_CONSOLE_SUBSYS=n

# for PDM microphone, set these three to y
# and also enable in overlay
CONFIG_AUDIO=n
CONFIG_AUDIO_DMIC=n
CONFIG_AUDIO_DMIC_NRFX_PDM=n

# Enable Bluetooth
CONFIG_BT=y
CONFIG_BT_PERIPHERAL=y
CONFIG_BT_CENTRAL=y
CONFIG_BT_DEVICE_NAME="XIAO BLE nRF52840 Sense"
CONFIG_BT_GATT_DYNAMIC_DB=y
CONFIG_BT_DEVICE_NAME_DYNAMIC=y
CONFIG_BT_GATT_CLIENT=y
CONFIG_BT_L2CAP_TX_MTU=252
CONFIG_BT_BUF_ACL_RX_SIZE=256
CONFIG_BT_GATT_ENFORCE_SUBSCRIPTION=n

CONFIG_MICROPY_HEAP_SIZE=98304
CONFIG_MAIN_STACK_SIZE=8192

# Enable drivers for peripherals
CONFIG_GPIO=y
CONFIG_I2C=y
CONFIG_SPI=y
CONFIG_PWM=y
CONFIG_ADC=y

CONFIG_FLASH=y
CONFIG_FLASH_MAP=y
CONFIG_FLASH_PAGE_LAYOUT=y

CONFIG_DISK_ACCESS=n

CONFIG_MICROPY_FROZEN_MODULES=y
CONFIG_MICROPY_FROZEN_MANIFEST="boards/xiao_ble_nrf52840_sense/manifest.py"
CONFIG_MICROPY_CONFIGFILE="boards/xiao_ble_nrf52840_sense/mpconfigport.h"

# CONFIG_DYNAMIC_THREAD=y
CONFIG_THREAD_CUSTOM_DATA=y
CONFIG_THREAD_MONITOR=y
CONFIG_THREAD_STACK_INFO=y

CONFIG_LOG=n
CONFIG_FP16=n
CONFIG_BOOT_BANNER=n
```

## py/Kconfig
```kconfig
comment "MicroPython options"


menu "Frozen modules"

config MICROPY_MODULE_FROZEN_STR
    bool "Frozen modules are supported in the form of strings"
    select CONFIG_MICROPY_MODULE_FROZEN

config MICROPY_MODULE_FROZEN_MPY
    bool "Frozen modules are supported in the form of .mpy files"
    select CONFIG_MICROPY_MODULE_FROZEN
    select MICROPY_PERSISTENT_CODE

config MICROPY_MODULE_FROZEN
    bool

endmenu # Frozen modules
```
