/* Memory layout for basic configuration:

    FLASH       .isr_vector
    FLASH       .text
    FLASH       .data

    RAM         .data
    RAM         .bss
    RAM         .heap
    RAM         .stack
*/

ENTRY(Reset_Handler)

/* define output sections */
SECTIONS
{
    /* The startup code goes first into FLASH */
    .isr_vector :
    {
        . = ALIGN(4);
        KEEP(*(.isr_vector)) /* Startup code */

        . = ALIGN(4);
    } >FLASH

    /* The program code and other data goes into FLASH */
    .text :
    {
        . = ALIGN(4);
#if MICROPY_SMALL_DATA_SECTION
        /* FLASH does not reside at 0x0, and MP_SMALL_DATA_* are the address based at 0x0.
           So deduct ORIGIN(FLASH) before ASSERTing it. This, of course, implies that
           MICROPY_SMALL_DATA_SECTION is relevant only for builds where the flash is aliased at 0x0. */
        ASSERT(. - ORIGIN(FLASH) == MP_SMALL_DATA_CONST_NONE, "bad MP_SMALL_DATA_CONST_NONE");
        /* KEEP required because some of these are left with no references
           if MICROPY_SMALL_DATA_SECTION is enabled */
        KEEP(*(.rodata.mp_const_none_obj))
        ASSERT(. - ORIGIN(FLASH) == MP_SMALL_DATA_CONST_FALSE, "bad MP_SMALL_DATA_CONST_FALSE");
        KEEP(*(.rodata.mp_const_false_obj))
        ASSERT(. - ORIGIN(FLASH) == MP_SMALL_DATA_CONST_TRUE, "bad MP_SMALL_DATA_CONST_TRUE");
        KEEP(*(.rodata.mp_const_true_obj))
        ASSERT(. - ORIGIN(FLASH) == MP_SMALL_DATA_TYPE_TYPE, "bad MP_SMALL_DATA_TYPE_TYPE");
        KEEP(*(.rodata._mp_type_type))
        . = ALIGN(4);
#endif
        *(.text*)          /* .text* sections (code) */
        *(.rodata*)        /* .rodata* sections (constants, strings, etc.) */
    /*  *(.glue_7)   */    /* glue arm to thumb code */
    /*  *(.glue_7t)  */    /* glue thumb to arm code */

        . = ALIGN(4);
        _etext = .;        /* define a global symbol at end of code */
    } >FLASH

    /* used by the startup to initialize data */
    _sidata = LOADADDR(.data);

    /* This is the initialized data section
    The program executes knowing that the data is in the RAM
    but the loader puts the initial values in the FLASH (inidata).
    It is one task of the startup to copy the initial values from FLASH to RAM. */
    .data :
    {
        . = ALIGN(4);
        _sdata = .;        /* create a global symbol at data start; used by startup code in order to initialise the .data section in RAM */
        *(.data*)          /* .data* sections */

        . = ALIGN(4);
        _edata = .;        /* define a global symbol at data end; used by startup code in order to initialise the .data section in RAM */
    } >RAM AT> FLASH

    /* Uninitialized data section */
    .bss :
    {
        . = ALIGN(4);
        _sbss = .;         /* define a global symbol at bss start; used by startup code */
        *(.bss*)
        *(COMMON)

        . = ALIGN(4);
        _ebss = .;         /* define a global symbol at bss end; used by startup code and GC */
    } >RAM

    /* this is to define the start of the heap, and make sure we have a minimum size */
    .heap :
    {
        . = ALIGN(4);
        . = . + _minimum_heap_size;
        . = ALIGN(4);
    } >RAM

    /* this just checks there is enough RAM for the stack */
    .stack :
    {
        . = ALIGN(4);
        . = . + _minimum_stack_size;
        . = ALIGN(4);
    } >RAM

    .ARM.attributes 0 : { *(.ARM.attributes) }
}
