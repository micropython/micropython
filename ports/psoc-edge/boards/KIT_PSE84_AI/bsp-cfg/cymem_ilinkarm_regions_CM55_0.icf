// This file is automatically generated.
// define memory with size = 4G;
define region m55_data_INTERNAL = [from CYMEM_CM55_0_m55_data_INTERNAL_START size CYMEM_CM55_0_m55_data_SIZE];
define region m55_data_sel = [from CYMEM_CM55_0_m55_data_INTERNAL_START size CYMEM_CM55_0_m55_data_SIZE];
define region m55_code_INTERNAL = [from CYMEM_CM55_0_m55_code_INTERNAL_START size CYMEM_CM55_0_m55_code_SIZE];
define region m55_code_sel = [from CYMEM_CM55_0_m55_code_INTERNAL_START size CYMEM_CM55_0_m55_code_SIZE];
define region user_nvm_C = [from CYMEM_CM55_0_user_nvm_C_START size CYMEM_CM55_0_user_nvm_SIZE];
define region user_nvm_sel = [from CYMEM_CM55_0_user_nvm_C_START size CYMEM_CM55_0_user_nvm_SIZE];
define region m55_nvm = [from CYMEM_CM55_0_m55_nvm_START size CYMEM_CM55_0_m55_nvm_SIZE];
define region m55_nvm_sel = [from CYMEM_CM55_0_m55_nvm_START size CYMEM_CM55_0_m55_nvm_SIZE];
define region m55_trailer = [from CYMEM_CM55_0_m55_trailer_START size CYMEM_CM55_0_m55_trailer_SIZE];
define region m55_trailer_sel = [from CYMEM_CM55_0_m55_trailer_START size CYMEM_CM55_0_m55_trailer_SIZE];
define region m55_code_secondary = [from CYMEM_CM55_0_m55_code_secondary_START size CYMEM_CM55_0_m55_code_secondary_SIZE];
define region m55_code_secondary_sel = [from CYMEM_CM55_0_m55_code_secondary_START size CYMEM_CM55_0_m55_code_secondary_SIZE];
define region m55_data_secondary = [from CYMEM_CM55_0_m55_data_secondary_START size CYMEM_CM55_0_m55_data_secondary_SIZE];
define region m55_data_secondary_sel = [from CYMEM_CM55_0_m55_data_secondary_START size CYMEM_CM55_0_m55_data_secondary_SIZE];
define region m33_m55_shared = [from CYMEM_CM55_0_m33_m55_shared_START size CYMEM_CM55_0_m33_m55_shared_SIZE];
define region m33_m55_shared_sel = [from CYMEM_CM55_0_m33_m55_shared_START size CYMEM_CM55_0_m33_m55_shared_SIZE];
define region gfx_mem = [from CYMEM_CM55_0_gfx_mem_START size CYMEM_CM55_0_gfx_mem_SIZE];
define region gfx_mem_sel = [from CYMEM_CM55_0_gfx_mem_START size CYMEM_CM55_0_gfx_mem_SIZE];
define region m33_data = [from CYMEM_CM55_0_m33_data_START size CYMEM_CM55_0_m33_data_SIZE];
define region m33_data_sel = [from CYMEM_CM55_0_m33_data_START size CYMEM_CM55_0_m33_data_SIZE];
define region m33s_allocatable_shared = [from CYMEM_CM55_0_m33s_allocatable_shared_START size CYMEM_CM55_0_m33s_allocatable_shared_SIZE];
define region m33s_allocatable_shared_sel = [from CYMEM_CM55_0_m33s_allocatable_shared_START size CYMEM_CM55_0_m33s_allocatable_shared_SIZE];
define region m33_allocatable_shared = [from CYMEM_CM55_0_m33_allocatable_shared_START size CYMEM_CM55_0_m33_allocatable_shared_SIZE];
define region m33_allocatable_shared_sel = [from CYMEM_CM55_0_m33_allocatable_shared_START size CYMEM_CM55_0_m33_allocatable_shared_SIZE];
define region m55_allocatable_shared = [from CYMEM_CM55_0_m55_allocatable_shared_START size CYMEM_CM55_0_m55_allocatable_shared_SIZE];
define region m55_allocatable_shared_sel = [from CYMEM_CM55_0_m55_allocatable_shared_START size CYMEM_CM55_0_m55_allocatable_shared_SIZE];
