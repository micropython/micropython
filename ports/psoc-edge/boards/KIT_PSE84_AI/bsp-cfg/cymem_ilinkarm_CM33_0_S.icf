// This file is automatically generated.
define exported symbol CYMEM_CM33_0_S_m55_data_START = 0x48040000;
define exported symbol CYMEM_CM33_0_S_m55_data_S_START = 0x58040000;
define exported symbol CYMEM_CM33_0_S_m55_data_SIZE = 0x00040000;
define exported symbol CYMEM_CM33_0_S_m55_data_OFFSET = 0x00000000;
define exported symbol CYMEM_CM33_0_S_m55_data_sel_START = CYMEM_CM33_0_S_m55_data_START;
define exported symbol CYMEM_CM33_0_S_m55_data_sel_S_START = CYMEM_CM33_0_S_m55_data_S_START;
define exported symbol CYMEM_CM33_0_S_m55_code_START = 0x48000000;
define exported symbol CYMEM_CM33_0_S_m55_code_S_START = 0x58000000;
define exported symbol CYMEM_CM33_0_S_m55_code_SIZE = 0x00040000;
define exported symbol CYMEM_CM33_0_S_m55_code_OFFSET = 0x00000000;
define exported symbol CYMEM_CM33_0_S_m55_code_sel_START = CYMEM_CM33_0_S_m55_code_START;
define exported symbol CYMEM_CM33_0_S_m55_code_sel_S_START = CYMEM_CM33_0_S_m55_code_S_START;
define exported symbol CYMEM_CM33_0_S_user_programmable_START = 0x22011000;
define exported symbol CYMEM_CM33_0_S_user_programmable_C_START = 0x02011000;
define exported symbol CYMEM_CM33_0_S_user_programmable_C_S_START = 0x12011000;
define exported symbol CYMEM_CM33_0_S_user_programmable_S_START = 0x32011000;
define exported symbol CYMEM_CM33_0_S_user_programmable_SIZE = 0x0004A000;
define exported symbol CYMEM_CM33_0_S_user_programmable_OFFSET = 0x00011000;
define exported symbol CYMEM_CM33_0_S_user_programmable_sel_START = CYMEM_CM33_0_S_user_programmable_C_START;
define exported symbol CYMEM_CM33_0_S_user_programmable_sel_S_START = CYMEM_CM33_0_S_user_programmable_C_S_START;
define exported symbol CYMEM_CM33_0_S_user_nvm_START = 0x2205B000;
define exported symbol CYMEM_CM33_0_S_user_nvm_C_START = 0x0205B000;
define exported symbol CYMEM_CM33_0_S_user_nvm_C_S_START = 0x1205B000;
define exported symbol CYMEM_CM33_0_S_user_nvm_S_START = 0x3205B000;
define exported symbol CYMEM_CM33_0_S_user_nvm_SIZE = 0x00008000;
define exported symbol CYMEM_CM33_0_S_user_nvm_OFFSET = 0x0005B000;
define exported symbol CYMEM_CM33_0_S_user_nvm_sel_START = CYMEM_CM33_0_S_user_nvm_C_START;
define exported symbol CYMEM_CM33_0_S_user_nvm_sel_S_START = CYMEM_CM33_0_S_user_nvm_C_S_START;
define exported symbol CYMEM_CM33_0_S_m33s_nvm_START = 0x60100000;
define exported symbol CYMEM_CM33_0_S_m33s_nvm_C_START = 0x08100000;
define exported symbol CYMEM_CM33_0_S_m33s_nvm_C_S_START = 0x18100000;
define exported symbol CYMEM_CM33_0_S_m33s_nvm_S_START = 0x70100000;
define exported symbol CYMEM_CM33_0_S_m33s_nvm_SIZE = 0x00200000;
define exported symbol CYMEM_CM33_0_S_m33s_nvm_OFFSET = 0x00100000;
define exported symbol CYMEM_CM33_0_S_m33s_nvm_sel_START = CYMEM_CM33_0_S_m33s_nvm_C_START;
define exported symbol CYMEM_CM33_0_S_m33s_nvm_sel_S_START = CYMEM_CM33_0_S_m33s_nvm_C_S_START;
define exported symbol CYMEM_CM33_0_S_m33s_trailer_START = 0x60300000;
define exported symbol CYMEM_CM33_0_S_m33s_trailer_C_START = 0x08300000;
define exported symbol CYMEM_CM33_0_S_m33s_trailer_C_S_START = 0x18300000;
define exported symbol CYMEM_CM33_0_S_m33s_trailer_S_START = 0x70300000;
define exported symbol CYMEM_CM33_0_S_m33s_trailer_SIZE = 0x00040000;
define exported symbol CYMEM_CM33_0_S_m33s_trailer_OFFSET = 0x00300000;
define exported symbol CYMEM_CM33_0_S_m33s_trailer_sel_START = CYMEM_CM33_0_S_m33s_trailer_C_START;
define exported symbol CYMEM_CM33_0_S_m33s_trailer_sel_S_START = CYMEM_CM33_0_S_m33s_trailer_C_S_START;
define exported symbol CYMEM_CM33_0_S_m33_nvm_START = 0x60340000;
define exported symbol CYMEM_CM33_0_S_m33_nvm_C_START = 0x08340000;
define exported symbol CYMEM_CM33_0_S_m33_nvm_C_S_START = 0x18340000;
define exported symbol CYMEM_CM33_0_S_m33_nvm_S_START = 0x70340000;
define exported symbol CYMEM_CM33_0_S_m33_nvm_SIZE = 0x00200000;
define exported symbol CYMEM_CM33_0_S_m33_nvm_OFFSET = 0x00340000;
define exported symbol CYMEM_CM33_0_S_m33_nvm_sel_START = CYMEM_CM33_0_S_m33_nvm_C_START;
define exported symbol CYMEM_CM33_0_S_m33_nvm_sel_S_START = CYMEM_CM33_0_S_m33_nvm_C_S_START;
define exported symbol CYMEM_CM33_0_S_m33_trailer_START = 0x60540000;
define exported symbol CYMEM_CM33_0_S_m33_trailer_C_START = 0x08540000;
define exported symbol CYMEM_CM33_0_S_m33_trailer_C_S_START = 0x18540000;
define exported symbol CYMEM_CM33_0_S_m33_trailer_S_START = 0x70540000;
define exported symbol CYMEM_CM33_0_S_m33_trailer_SIZE = 0x00040000;
define exported symbol CYMEM_CM33_0_S_m33_trailer_OFFSET = 0x00540000;
define exported symbol CYMEM_CM33_0_S_m33_trailer_sel_START = CYMEM_CM33_0_S_m33_trailer_C_START;
define exported symbol CYMEM_CM33_0_S_m33_trailer_sel_S_START = CYMEM_CM33_0_S_m33_trailer_C_S_START;
define exported symbol CYMEM_CM33_0_S_m55_nvm_START = 0x60580000;
define exported symbol CYMEM_CM33_0_S_m55_nvm_C_START = 0x08580000;
define exported symbol CYMEM_CM33_0_S_m55_nvm_C_S_START = 0x18580000;
define exported symbol CYMEM_CM33_0_S_m55_nvm_S_START = 0x70580000;
define exported symbol CYMEM_CM33_0_S_m55_nvm_SIZE = 0x002C0000;
define exported symbol CYMEM_CM33_0_S_m55_nvm_OFFSET = 0x00580000;
define exported symbol CYMEM_CM33_0_S_m55_nvm_sel_START = CYMEM_CM33_0_S_m55_nvm_C_START;
define exported symbol CYMEM_CM33_0_S_m55_nvm_sel_S_START = CYMEM_CM33_0_S_m55_nvm_C_S_START;
define exported symbol CYMEM_CM33_0_S_m55_trailer_START = 0x60840000;
define exported symbol CYMEM_CM33_0_S_m55_trailer_C_START = 0x08840000;
define exported symbol CYMEM_CM33_0_S_m55_trailer_C_S_START = 0x18840000;
define exported symbol CYMEM_CM33_0_S_m55_trailer_S_START = 0x70840000;
define exported symbol CYMEM_CM33_0_S_m55_trailer_SIZE = 0x00040000;
define exported symbol CYMEM_CM33_0_S_m55_trailer_OFFSET = 0x00840000;
define exported symbol CYMEM_CM33_0_S_m55_trailer_sel_START = CYMEM_CM33_0_S_m55_trailer_C_START;
define exported symbol CYMEM_CM33_0_S_m55_trailer_sel_S_START = CYMEM_CM33_0_S_m55_trailer_C_S_START;
define exported symbol CYMEM_CM33_0_S_m55_code_secondary_START = 0x26000000;
define exported symbol CYMEM_CM33_0_S_m55_code_secondary_C_START = 0x06000000;
define exported symbol CYMEM_CM33_0_S_m55_code_secondary_C_S_START = 0x16000000;
define exported symbol CYMEM_CM33_0_S_m55_code_secondary_S_START = 0x36000000;
define exported symbol CYMEM_CM33_0_S_m55_code_secondary_SIZE = 0x00040000;
define exported symbol CYMEM_CM33_0_S_m55_code_secondary_OFFSET = 0x00000000;
define exported symbol CYMEM_CM33_0_S_m55_code_secondary_sel_START = CYMEM_CM33_0_S_m55_code_secondary_C_START;
define exported symbol CYMEM_CM33_0_S_m55_code_secondary_sel_S_START = CYMEM_CM33_0_S_m55_code_secondary_C_S_START;
define exported symbol CYMEM_CM33_0_S_m55_data_secondary_START = 0x26040000;
define exported symbol CYMEM_CM33_0_S_m55_data_secondary_C_START = 0x06040000;
define exported symbol CYMEM_CM33_0_S_m55_data_secondary_C_S_START = 0x16040000;
define exported symbol CYMEM_CM33_0_S_m55_data_secondary_S_START = 0x36040000;
define exported symbol CYMEM_CM33_0_S_m55_data_secondary_SIZE = 0x002BC000;
define exported symbol CYMEM_CM33_0_S_m55_data_secondary_OFFSET = 0x00040000;
define exported symbol CYMEM_CM33_0_S_m55_data_secondary_sel_START = CYMEM_CM33_0_S_m55_data_secondary_C_START;
define exported symbol CYMEM_CM33_0_S_m55_data_secondary_sel_S_START = CYMEM_CM33_0_S_m55_data_secondary_C_S_START;
define exported symbol CYMEM_CM33_0_S_m33_m55_shared_START = 0x262FC000;
define exported symbol CYMEM_CM33_0_S_m33_m55_shared_C_START = 0x062FC000;
define exported symbol CYMEM_CM33_0_S_m33_m55_shared_C_S_START = 0x162FC000;
define exported symbol CYMEM_CM33_0_S_m33_m55_shared_S_START = 0x362FC000;
define exported symbol CYMEM_CM33_0_S_m33_m55_shared_SIZE = 0x00040000;
define exported symbol CYMEM_CM33_0_S_m33_m55_shared_OFFSET = 0x002FC000;
define exported symbol CYMEM_CM33_0_S_m33_m55_shared_sel_START = CYMEM_CM33_0_S_m33_m55_shared_C_START;
define exported symbol CYMEM_CM33_0_S_m33_m55_shared_sel_S_START = CYMEM_CM33_0_S_m33_m55_shared_C_S_START;
define exported symbol CYMEM_CM33_0_S_gfx_mem_START = 0x2633C000;
define exported symbol CYMEM_CM33_0_S_gfx_mem_C_START = 0x0633C000;
define exported symbol CYMEM_CM33_0_S_gfx_mem_C_S_START = 0x1633C000;
define exported symbol CYMEM_CM33_0_S_gfx_mem_S_START = 0x3633C000;
define exported symbol CYMEM_CM33_0_S_gfx_mem_SIZE = 0x001C4000;
define exported symbol CYMEM_CM33_0_S_gfx_mem_OFFSET = 0x0033C000;
define exported symbol CYMEM_CM33_0_S_gfx_mem_sel_START = CYMEM_CM33_0_S_gfx_mem_C_START;
define exported symbol CYMEM_CM33_0_S_gfx_mem_sel_S_START = CYMEM_CM33_0_S_gfx_mem_C_S_START;
define exported symbol CYMEM_CM33_0_S_m33s_shared_START = 0x24001000;
define exported symbol CYMEM_CM33_0_S_m33s_shared_C_START = 0x04001000;
define exported symbol CYMEM_CM33_0_S_m33s_shared_C_S_START = 0x14001000;
define exported symbol CYMEM_CM33_0_S_m33s_shared_S_START = 0x34001000;
define exported symbol CYMEM_CM33_0_S_m33s_shared_SIZE = 0x00001000;
define exported symbol CYMEM_CM33_0_S_m33s_shared_OFFSET = 0x00001000;
define exported symbol CYMEM_CM33_0_S_m33s_shared_sel_START = CYMEM_CM33_0_S_m33s_shared_C_START;
define exported symbol CYMEM_CM33_0_S_m33s_shared_sel_S_START = CYMEM_CM33_0_S_m33s_shared_C_S_START;
define exported symbol CYMEM_CM33_0_S_m33s_code_START = 0x24002000;
define exported symbol CYMEM_CM33_0_S_m33s_code_C_START = 0x04002000;
define exported symbol CYMEM_CM33_0_S_m33s_code_C_S_START = 0x14002000;
define exported symbol CYMEM_CM33_0_S_m33s_code_S_START = 0x34002000;
define exported symbol CYMEM_CM33_0_S_m33s_code_SIZE = 0x00035000;
define exported symbol CYMEM_CM33_0_S_m33s_code_OFFSET = 0x00002000;
define exported symbol CYMEM_CM33_0_S_m33s_code_sel_START = CYMEM_CM33_0_S_m33s_code_C_START;
define exported symbol CYMEM_CM33_0_S_m33s_code_sel_S_START = CYMEM_CM33_0_S_m33s_code_C_S_START;
define exported symbol CYMEM_CM33_0_S_m33s_data_START = 0x24037000;
define exported symbol CYMEM_CM33_0_S_m33s_data_C_START = 0x04037000;
define exported symbol CYMEM_CM33_0_S_m33s_data_C_S_START = 0x14037000;
define exported symbol CYMEM_CM33_0_S_m33s_data_S_START = 0x34037000;
define exported symbol CYMEM_CM33_0_S_m33s_data_SIZE = 0x00021000;
define exported symbol CYMEM_CM33_0_S_m33s_data_OFFSET = 0x00037000;
define exported symbol CYMEM_CM33_0_S_m33s_data_sel_START = CYMEM_CM33_0_S_m33s_data_C_START;
define exported symbol CYMEM_CM33_0_S_m33s_data_sel_S_START = CYMEM_CM33_0_S_m33s_data_C_S_START;
define exported symbol CYMEM_CM33_0_S_m33_code_START = 0x24058000;
define exported symbol CYMEM_CM33_0_S_m33_code_C_START = 0x04058000;
define exported symbol CYMEM_CM33_0_S_m33_code_C_S_START = 0x14058000;
define exported symbol CYMEM_CM33_0_S_m33_code_S_START = 0x34058000;
define exported symbol CYMEM_CM33_0_S_m33_code_SIZE = 0x00065000;
define exported symbol CYMEM_CM33_0_S_m33_code_OFFSET = 0x00058000;
define exported symbol CYMEM_CM33_0_S_m33_code_sel_START = CYMEM_CM33_0_S_m33_code_C_START;
define exported symbol CYMEM_CM33_0_S_m33_code_sel_S_START = CYMEM_CM33_0_S_m33_code_C_S_START;
define exported symbol CYMEM_CM33_0_S_m33_data_START = 0x240BD000;
define exported symbol CYMEM_CM33_0_S_m33_data_C_START = 0x040BD000;
define exported symbol CYMEM_CM33_0_S_m33_data_C_S_START = 0x140BD000;
define exported symbol CYMEM_CM33_0_S_m33_data_S_START = 0x340BD000;
define exported symbol CYMEM_CM33_0_S_m33_data_SIZE = 0x00040000;
define exported symbol CYMEM_CM33_0_S_m33_data_OFFSET = 0x000BD000;
define exported symbol CYMEM_CM33_0_S_m33_data_sel_START = CYMEM_CM33_0_S_m33_data_C_START;
define exported symbol CYMEM_CM33_0_S_m33_data_sel_S_START = CYMEM_CM33_0_S_m33_data_C_S_START;
define exported symbol CYMEM_CM33_0_S_m33s_allocatable_shared_START = 0x240FD000;
define exported symbol CYMEM_CM33_0_S_m33s_allocatable_shared_C_START = 0x040FD000;
define exported symbol CYMEM_CM33_0_S_m33s_allocatable_shared_C_S_START = 0x140FD000;
define exported symbol CYMEM_CM33_0_S_m33s_allocatable_shared_S_START = 0x340FD000;
define exported symbol CYMEM_CM33_0_S_m33s_allocatable_shared_SIZE = 0x00001000;
define exported symbol CYMEM_CM33_0_S_m33s_allocatable_shared_OFFSET = 0x000FD000;
define exported symbol CYMEM_CM33_0_S_m33s_allocatable_shared_sel_START = CYMEM_CM33_0_S_m33s_allocatable_shared_C_START;
define exported symbol CYMEM_CM33_0_S_m33s_allocatable_shared_sel_S_START = CYMEM_CM33_0_S_m33s_allocatable_shared_C_S_START;
define exported symbol CYMEM_CM33_0_S_m33_allocatable_shared_START = 0x240FE000;
define exported symbol CYMEM_CM33_0_S_m33_allocatable_shared_C_START = 0x040FE000;
define exported symbol CYMEM_CM33_0_S_m33_allocatable_shared_C_S_START = 0x140FE000;
define exported symbol CYMEM_CM33_0_S_m33_allocatable_shared_S_START = 0x340FE000;
define exported symbol CYMEM_CM33_0_S_m33_allocatable_shared_SIZE = 0x00001000;
define exported symbol CYMEM_CM33_0_S_m33_allocatable_shared_OFFSET = 0x000FE000;
define exported symbol CYMEM_CM33_0_S_m33_allocatable_shared_sel_START = CYMEM_CM33_0_S_m33_allocatable_shared_C_START;
define exported symbol CYMEM_CM33_0_S_m33_allocatable_shared_sel_S_START = CYMEM_CM33_0_S_m33_allocatable_shared_C_S_START;
define exported symbol CYMEM_CM33_0_S_m55_allocatable_shared_START = 0x240FF000;
define exported symbol CYMEM_CM33_0_S_m55_allocatable_shared_C_START = 0x040FF000;
define exported symbol CYMEM_CM33_0_S_m55_allocatable_shared_C_S_START = 0x140FF000;
define exported symbol CYMEM_CM33_0_S_m55_allocatable_shared_S_START = 0x340FF000;
define exported symbol CYMEM_CM33_0_S_m55_allocatable_shared_SIZE = 0x00001000;
define exported symbol CYMEM_CM33_0_S_m55_allocatable_shared_OFFSET = 0x000FF000;
define exported symbol CYMEM_CM33_0_S_m55_allocatable_shared_sel_START = CYMEM_CM33_0_S_m55_allocatable_shared_C_START;
define exported symbol CYMEM_CM33_0_S_m55_allocatable_shared_sel_S_START = CYMEM_CM33_0_S_m55_allocatable_shared_C_S_START;
