## prj.conf
```kconfig
CONFIG_STDOUT_CONSOLE=y
CONFIG_CONSOLE_HANDLER=y
CONFIG_UART_CONSOLE_DEBUG_SERVER_HOOKS=y
CONFIG_NEWLIB_LIBC=y
CONFIG_FLOAT=y
```

## prj_96b_carbon.conf
```kconfig
# TODO: Enable networking
CONFIG_NETWORKING=n
```

## prj_base.conf
```kconfig
CONFIG_LEGACY_KERNEL=n
CONFIG_REBOOT=y

CONFIG_STDOUT_CONSOLE=y
CONFIG_CONSOLE_HANDLER=y
CONFIG_UART_CONSOLE_DEBUG_SERVER_HOOKS=y
CONFIG_NEWLIB_LIBC=y
CONFIG_FLOAT=y
CONFIG_MAIN_STACK_SIZE=4096

# Networking config
CONFIG_NETWORKING=y
CONFIG_NET_IPV4=y
CONFIG_NET_IPV6=y
CONFIG_NET_UDP=y
CONFIG_NET_TCP=y
CONFIG_NET_SOCKETS=y
CONFIG_TEST_RANDOM_GENERATOR=y
CONFIG_NET_NBUF_RX_COUNT=5

# DNS
CONFIG_DNS_RESOLVER=y
CONFIG_DNS_RESOLVER_ADDITIONAL_QUERIES=2
CONFIG_DNS_SERVER_IP_ADDRESSES=y
CONFIG_DNS_SERVER1="192.0.2.2"

# Diagnostics and debugging

# Required for zephyr.stack_analyze()
CONFIG_INIT_STACKS=y

# Required for usocket.pkt_get_info()
CONFIG_NET_BUF_POOL_USAGE=y

# Required for usocket.shell_*()
#CONFIG_NET_SHELL=y

# Uncomment to enable "INFO" level net_buf logging
#CONFIG_NET_LOG=y
#CONFIG_NET_DEBUG_NET_BUF=y
# Change to 4 for "DEBUG" level
#CONFIG_SYS_LOG_NET_LEVEL=3
```

## prj_frdm_k64f.conf
```kconfig
# Networking drivers
CONFIG_NET_L2_ETHERNET=y
```

## prj_qemu_cortex_m3.conf
```kconfig
# Networking drivers
# SLIP driver for QEMU
CONFIG_NET_SLIP_TAP=y
```

## prj_qemu_x86.conf
```kconfig
# Networking drivers
# SLIP driver for QEMU
CONFIG_NET_SLIP_TAP=y

# Default RAM easily overflows with uPy and networking
CONFIG_RAM_SIZE=320
```

## src/zephyr_getchar.c
```c
/*
 * Copyright (c) 2016 Linaro
 *
 * Licensed under the Apache License, Version 2.0 (the "License");
 * you may not use this file except in compliance with the License.
 * You may obtain a copy of the License at
 *
 *     http://www.apache.org/licenses/LICENSE-2.0
 *
 * Unless required by applicable law or agreed to in writing, software
 * distributed under the License is distributed on an "AS IS" BASIS,
 * WITHOUT WARRANTIES OR CONDITIONS OF ANY KIND, either express or implied.
 * See the License for the specific language governing permissions and
 * limitations under the License.
 */

#include <zephyr.h>
#include <uart.h>
#include <drivers/console/uart_console.h>
#include <misc/printk.h>
#include "zephyr_getchar.h"

extern int mp_interrupt_char;
void mp_keyboard_interrupt(void);

static struct nano_sem uart_sem;
#define UART_BUFSIZE 256
static uint8_t uart_ringbuf[UART_BUFSIZE];
static uint8_t i_get, i_put;

static int console_irq_input_hook(uint8_t ch)
{
    int i_next = (i_put + 1) & (UART_BUFSIZE - 1);
    if (i_next == i_get) {
        printk("UART buffer overflow - char dropped\n");
        return 1;
    }
    if (ch == mp_interrupt_char) {
        mp_keyboard_interrupt();
        return 1;
    } else {
        uart_ringbuf[i_put] = ch;
        i_put = i_next;
    }
    //printk("%x\n", ch);
    nano_isr_sem_give(&uart_sem);
    return 1;
}

uint8_t zephyr_getchar(void) {
    nano_task_sem_take(&uart_sem, TICKS_UNLIMITED);
    unsigned int key = irq_lock();
    uint8_t c = uart_ringbuf[i_get++];
    i_get &= UART_BUFSIZE - 1;
    irq_unlock(key);
    return c;
}

void zephyr_getchar_init(void) {
    nano_sem_init(&uart_sem);
    uart_console_in_debug_hook_install(console_irq_input_hook);
    // All NULLs because we're interested only in the callback above
    uart_register_input(NULL, NULL, NULL);
}
```

## src/zephyr_start.c
```c
#include <zephyr.h>
#include "zephyr_getchar.h"

int real_main(void);

void main(void) {
    zephyr_getchar_init();
    real_main();
}
```
